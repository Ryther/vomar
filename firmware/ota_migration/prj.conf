## CMakeLists.txt
```
cmake_minimum_required(VERSION 3.20.0)
find_package(Zephyr REQUIRED HINTS $ENV{ZEPHYR_BASE})
project(vimar_ota_recovery_migration)
if(NOT DEFINED GENERATED_DIR)
 message(FATAL_ERROR "GENERATED_DIR must contain validated migration bundle headers")
endif()
if(CONFIG_MIGRATION_COMMON AND NOT CONFIG_VIMAR_LOADER_RUNTIME_V2 AND NOT EXISTS "${GENERATED_DIR}/common_platform.h")
 message(FATAL_ERROR "Common migration requires frozen common_platform.h authorization")
endif()
target_sources(app PRIVATE src/main.c src/migration_copy.c ../ota/ota_image.c)
target_include_directories(app PRIVATE src ../ota ${GENERATED_DIR})
target_compile_definitions(app PRIVATE OTA_IMAGE_AUTH_ONLY)
if(CONFIG_MIGRATION_STAGE_PROBE)
 target_sources(app PRIVATE ../ota/ota_storage.c ../ota/ota_transaction.c ../ota/ota_format.c)
endif()
if(CONFIG_MIGRATION_LEGACY_ZIGBEE_ENTRY)
 target_sources(app PRIVATE src/legacy_bridge_policy.c src/legacy_bridge_flow.c
   src/legacy_bridge_entry_zephyr.c ../ota/ota_transaction.c ../src/boot_trace.c)
endif()

if(CONFIG_VIMAR_OTA_SPLIT_STAGING)
 target_sources(app PRIVATE src/migration_policy.c ../src/vimar_power_protection.c ../src/candidate_power_protection.c ../research/src/research_handoff.c)
 target_include_directories(app PRIVATE ../src ../research/src)
endif()

include(${CMAKE_CURRENT_SOURCE_DIR}/../loader_contract/runtime.cmake)
```

## Kconfig
```
mainmenu "BLE recovery migration"
source "Kconfig.zephyr"
config MIGRATION_COMMON
 bool "Common migration for an explicit finite loader allowlist"
 depends on SOC_NRF52840 && VIMAR_OTA_SPLIT_STAGING
 default n
 help
   Uses generated common_platform.h instead of a per-device target_uid.h.
   Requires authenticated RECOVERY role/profile2 and keeps runtime UID checks.
   Unknown legacy/future loaders remain unsupported.

config MIGRATION_STAGE_PROBE
 bool "Bench-only arm an independently staged OTA candidate after migration"
 depends on !MIGRATION_COMMON
 default n

config MIGRATION_LEGACY_ZIGBEE_ENTRY
 bool "Authenticated profile1 Zigbee bridge into common recovery"
 depends on MIGRATION_COMMON && !VIMAR_LOADER_RUNTIME_V2 && !MIGRATION_STAGE_PROBE
 default n
 help
   Opt-in legacy OTA entry with executing-image-bound transaction/checkpoint
   admission. Only the bridge primary uses profile1; embedded recovery still
   requires authenticated profile2 RECOVERY role and a finite legacy loader.

rsource "../Kconfig.protection"
```

## prj.conf
```kconfig
CONFIG_FLASH=y
CONFIG_FLASH_MAP=y
CONFIG_BOOTLOADER_MCUBOOT=y
CONFIG_MCUBOOT_BOOTLOADER_MODE_FIRMWARE_UPDATER=y
CONFIG_DISABLE_FLASH_PATCH=n
CONFIG_RETAINED_MEM=y
CONFIG_RETENTION=y
CONFIG_RETENTION_BOOT_MODE=y
CONFIG_SERIAL=n
CONFIG_CONSOLE=n
CONFIG_UART_CONSOLE=n
CONFIG_LOG=y
CONFIG_LOG_DEFAULT_LEVEL=3
CONFIG_USE_SEGGER_RTT=y
CONFIG_LOG_BACKEND_RTT=y
CONFIG_SEGGER_RTT_INIT_MODE_ALWAYS=y
CONFIG_LOG_BACKEND_UART=n
CONFIG_LTO=y
CONFIG_ISR_TABLES_LOCAL_DECLARATION=y
CONFIG_MAIN_STACK_SIZE=8192
CONFIG_PSA_CRYPTO=y
CONFIG_PSA_WANT_ALG_ECDSA=y
CONFIG_PSA_WANT_ALG_SHA_256=y
CONFIG_PSA_WANT_ECC_SECP_R1_256=y
CONFIG_PSA_WANT_KEY_TYPE_ECC_PUBLIC_KEY=y

# SDK Oberon gates public ECC import on the key-pair import dispatcher.
CONFIG_PSA_WANT_KEY_TYPE_ECC_KEY_PAIR_IMPORT=y

CONFIG_REBOOT=y
```

## src/main.c
```c
/* Signed primary remains valid while recovery pages are copied/retried.
 * Never initializes output pins, consumes handoff marker, or changes loader. */
#include <zephyr/kernel.h>
#include <zephyr/drivers/flash.h>
#include <zephyr/retention/bootmode.h>
#include <zephyr/sys/reboot.h>
#include <zephyr/logging/log.h>
#include <hal/nrf_ficr.h>
#include <psa/crypto.h>
#include <errno.h>
#include <string.h>
#include "migration_copy.h"
#include "ota_image.h"
#include "recovery_blob.h"
#if defined(CONFIG_MIGRATION_LEGACY_ZIGBEE_ENTRY)
#include "legacy_bridge_entry_zephyr.h"
#endif
#if defined(CONFIG_VIMAR_LOADER_RUNTIME_V2)
#include "loader_runtime_zephyr.h"
#elif defined(CONFIG_MIGRATION_COMMON)
#include "common_platform.h"
#else
#include "target_uid.h"
#endif
#if defined(CONFIG_VIMAR_OTA_SPLIT_STAGING)
#include "migration_policy.h"
#include "vimar_power_protection.h"
#include <zephyr/settings/settings.h>
#include <zephyr/drivers/retained_mem.h>
static const struct device *marker=DEVICE_DT_GET(DT_NODELABEL(gpregret2));
static int warm_load(void*c,uint8_t*p,size_t n){ARG_UNUSED(c);ssize_t r=settings_load_one("vimar/handoff",p,n);return r==(ssize_t)n?0:-EIO;}
static int warm_get(void*c,uint8_t*p){ARG_UNUSED(c);return retained_mem_read(marker,0,p,1);}
static int warm_set(void*c,uint8_t p){ARG_UNUSED(c);return retained_mem_write(marker,0,&p,1);}
static const struct research_handoff_io warm_io={.load=warm_load,.get_marker=warm_get,.set_marker=warm_set};
static int protected_preflight(const uint32_t uid[2],const uint8_t loader_digest[32]){
 int rc=settings_subsys_init();if(rc)return rc;
#if defined(CONFIG_MIGRATION_LEGACY_ZIGBEE_ENTRY)
 rc=legacy_bridge_prepare(uid,loader_digest,expected_recovery_sha256);if(rc)return rc;
#else
 ARG_UNUSED(uid);ARG_UNUSED(loader_digest);
#endif
 uint8_t old[176];ssize_t n=settings_load_one("vimar/ota",old,sizeof(old));
 rc=migration_protection_preflight((int)n,&warm_io);if(rc)return rc;
 return vimar_power_protection_init();
}
#endif
#if defined(CONFIG_MIGRATION_STAGE_PROBE)
#include <zephyr/settings/settings.h>
#include "ota_storage.h"
#include "probe_manifest.h"
#endif
LOG_MODULE_REGISTER(vimar_migration,LOG_LEVEL_INF);
static const struct device *flash_dev=DEVICE_DT_GET(DT_CHOSEN(zephyr_flash_controller));
static int read_uid(void *ctx,uint32_t uid[2]){ARG_UNUSED(ctx);uid[0]=nrf_ficr_deviceid_get(NRF_FICR,0);uid[1]=nrf_ficr_deviceid_get(NRF_FICR,1);return 0;}
static int digest(void *ctx,const uint8_t *p,size_t n,uint8_t out[32]){ARG_UNUSED(ctx);return ota_image_sha256(p,n,out);}
static int verify_image(void *ctx,const uint8_t *p,size_t n){
 ARG_UNUSED(ctx);struct ota_image_info info;
#if defined(CONFIG_MIGRATION_COMMON)
 int rc=ota_image_verify_primary_for_profile(p,n,2,&info);
 return rc?rc:migration_common_recovery_authorized(&info,n);
#else
 int rc=ota_image_verify_primary(p,n,&info);return rc?rc:(info.output_size==n?0:-EBADMSG);
#endif
}
static int read_flash(void *ctx,uint32_t addr,uint8_t *p,size_t n){ARG_UNUSED(ctx);return flash_read(flash_dev,addr,p,n);}
static int erase_flash(void *ctx,uint32_t addr,size_t n){ARG_UNUSED(ctx);return flash_erase(flash_dev,addr,n);}
static int write_flash(void *ctx,uint32_t addr,const uint8_t *p,size_t n){ARG_UNUSED(ctx);return flash_write(flash_dev,addr,p,n);}
static int verify_loader(uint8_t actual_digest[32])
{
#if defined(CONFIG_VIMAR_LOADER_RUNTIME_V2)
 if(actual_digest)return-ENOTSUP;
 struct loader_runtime_identity identity;
 return loader_runtime_zephyr_snapshot(&identity);
#else
 uint8_t buf[256],hash[32];size_t size=0;
 psa_hash_operation_t h=psa_hash_operation_init();
 if(psa_crypto_init()!=PSA_SUCCESS||psa_hash_setup(&h,PSA_ALG_SHA_256)!=PSA_SUCCESS)return-EIO;
 int rc=0;
 for(uint32_t addr=0;addr<0xc000&&!rc;addr+=sizeof(buf)){
  rc=flash_read(flash_dev,addr,buf,sizeof(buf));
  if(!rc&&psa_hash_update(&h,buf,sizeof(buf))!=PSA_SUCCESS)rc=-EIO;
 }
 if(!rc&&(psa_hash_finish(&h,hash,sizeof(hash),&size)!=PSA_SUCCESS||size!=32))rc=-EIO;
 psa_hash_abort(&h);
 if(rc)return rc;
 if(actual_digest)memcpy(actual_digest,hash,32);
#if defined(CONFIG_MIGRATION_COMMON)
 return migration_common_loader_authorized(hash,migration_allowed_loaders,MIGRATION_ALLOWED_LOADER_COUNT);
#else
 return memcmp(hash,expected_loader_sha256,32)?-EACCES:0;
#endif
#endif
}
int main(void)
{
 uint32_t uid[2];read_uid(NULL,uid);
#if defined(CONFIG_MIGRATION_COMMON)
 if(NRF_FICR->INFO.PART!=0x52840u){LOG_ERR("Unsupported MCU; stopped before any mutation");return 0;}
#else
 if(uid[0]!=MIGRATION_UID0||uid[1]!=MIGRATION_UID1){LOG_ERR("Wrong target; stopped before any mutation");return 0;}
#endif
 if(!device_is_ready(flash_dev)){LOG_ERR("Flash not ready");return 0;}
 uint8_t loader_digest[32]={0};
#if defined(CONFIG_MIGRATION_LEGACY_ZIGBEE_ENTRY)
 int rc=verify_loader(loader_digest);
#else
 int rc=verify_loader(NULL);
#endif
 if(rc){LOG_ERR("Loader authorization mismatch: %d",rc);return 0;}
#if defined(CONFIG_MIGRATION_COMMON)
 rc=verify_image(NULL,recovery_blob,RECOVERY_BLOB_SIZE);
 if(rc){LOG_ERR("Common recovery authorization mismatch: %d",rc);return 0;}
#endif
#if defined(CONFIG_VIMAR_OTA_SPLIT_STAGING)
 rc=protected_preflight(uid,loader_digest);
 if(rc){LOG_ERR("Protected migration preflight rejected: %d",rc);
  if(!bootmode_set(BOOT_MODE_TYPE_BOOTLOADER))sys_reboot(SYS_REBOOT_COLD);
  return 0;
 }
#endif
 /* A reset while writing recovery must return to this valid primary. */
 rc=bootmode_clear();if(rc){LOG_ERR("Cannot clear boot request: %d",rc);return 0;}
 /* The common image binds this attempt to locally read identity. The copy
  * engine independently rereads those UID words before every copy/retry. */
#if defined(CONFIG_MIGRATION_COMMON)
 const struct migration_copy_bundle bundle={.uid={uid[0],uid[1]},.data=recovery_blob,.size=RECOVERY_BLOB_SIZE};
#else
 const struct migration_copy_bundle bundle={.uid={MIGRATION_UID0,MIGRATION_UID1},.data=recovery_blob,.size=RECOVERY_BLOB_SIZE};
#endif
 struct migration_copy_bundle checked=bundle;
#if defined(CONFIG_VIMAR_LOADER_RUNTIME_V2)
 /* The fixed embedded blob was already authenticated above. This full-file
  * consistency digest is not loader authority or the REC signed-region hash. */
 rc=ota_image_sha256(recovery_blob,RECOVERY_BLOB_SIZE,checked.sha256);
 if(rc){LOG_ERR("Recovery consistency digest unavailable: %d",rc);return 0;}
#else
 memcpy(checked.sha256,expected_recovery_sha256,32);
#endif
 const struct migration_copy_io io={.read_uid=read_uid,.sha256=digest,.verify_image=verify_image,.read=read_flash,.erase=erase_flash,.write=write_flash};
 for(;;){
  rc=migration_copy_run(&checked,&io);
  if(!rc)break;
  LOG_ERR("Recovery migration paused: %d; retaining valid primary",rc);k_sleep(K_SECONDS(2));
 }
#if defined(CONFIG_VIMAR_OTA_SPLIT_STAGING)
 while(vimar_power_protection_flush()){LOG_ERR("Protection checkpoint unavailable; migration retains valid primary");k_sleep(K_SECONDS(1));}
#endif
 LOG_INF("Device recovery copied and verified; loader/identity unchanged");
#if defined(CONFIG_MIGRATION_STAGE_PROBE)
 rc=settings_subsys_init();
 if(!rc){struct ota_image_info info;rc=ota_image_authenticate((const uint8_t*)PROBE_STAGE_START,PROBE_CANDIDATE_SIZE,PROBE_STAGE_START-0xc000,&info);
  if(!rc){struct ota_transaction tx={.format_version=1,.generation=1,.state=OTA_TRANSACTION_PENDING,.stage_start=PROBE_STAGE_START,.stage_end=0xae000,.candidate_size=PROBE_CANDIDATE_SIZE,.signed_image_size=info.output_size};memcpy(tx.candidate_digest,info.source_digest,32);memcpy(tx.final_digest,info.signed_digest,32);rc=ota_storage_save(&tx);}
 }
 if(rc){LOG_ERR("Bench staged candidate rejected: %d",rc);return 0;}
#endif
#if defined(CONFIG_MIGRATION_LEGACY_ZIGBEE_ENTRY)
 rc=legacy_bridge_record_recovery_entry();
 if(rc){LOG_ERR("Permanent recovery entry checkpoint failed: %d",rc);return 0;}
#endif
 rc=bootmode_set(BOOT_MODE_TYPE_BOOTLOADER);
 if(rc){LOG_ERR("Recovery boot request failed: %d",rc);return 0;}
 sys_reboot(SYS_REBOOT_COLD);return 0;
}
```

## src/legacy_bridge_entry_zephyr.c
```c
/* Legacy profile1 OTA admission. The caller authenticates the embedded REC and
 * finite loader allowlist first. No bond, primary, loader or UICR writes. */
#include "legacy_bridge_entry_zephyr.h"
#include "legacy_bridge_flow.h"
#include "legacy_recovery_policy.h"
#include "ota_image.h"
#include "boot_trace.h"
#include <zephyr/settings/settings.h>
#include <zephyr/retention/bootmode.h>
#include <errno.h>
#include <string.h>

struct bridge_context {char checkpoint_key[64];};
static const char tx_key[]="vimar/ota";

static int load(void *opaque,enum legacy_bridge_key key,uint8_t *out,size_t capacity,size_t *size)
{
 struct bridge_context *ctx=opaque;
 const char *name=key==LEGACY_BRIDGE_TRANSACTION?tx_key:ctx->checkpoint_key;
 *size=0;
 ssize_t stored=settings_get_val_len(name);
 if(stored==-ENOENT)return 0;
 if(stored<0)return(int)stored;
 if(!stored)return 0;
 if((size_t)stored>capacity)return-EOVERFLOW;
 ssize_t n=settings_load_one(name,out,capacity);
 if(n!=stored)return n<0?(int)n:-EIO;
 *size=(size_t)n;return 0;
}
static int save_checkpoint(void *opaque,const uint8_t *record,size_t size)
{
 struct bridge_context *ctx=opaque;
 return settings_save_one(ctx->checkpoint_key,record,size);
}
static int clear_transaction(void *ctx){(void)ctx;return settings_delete(tx_key);}
static int clear_boot(void *ctx){(void)ctx;return bootmode_clear();}
static int verify_legacy_recovery(void *ctx)
{
 (void)ctx;struct ota_image_info info;
 int rc=ota_image_verify_primary_for_profile((const uint8_t *)0xb0000,0x40000,1,&info);
 if(rc)return rc;
 return info.authenticated_role==OTA_IMAGE_ROLE_NONE &&
  !memcmp(info.signed_digest,legacy_source_recovery_digest,32)?0:-EACCES;
}
int legacy_bridge_prepare(const uint32_t uid[2],const uint8_t loader_digest[32],
                          const uint8_t recovery_digest[32])
{
 if(!uid||!loader_digest||!recovery_digest)return-EINVAL;
 struct ota_image_info self;
 int rc=ota_image_verify_primary_for_profile((const uint8_t *)0xc000,0xa2000,1,&self);
 if(rc)return rc;
 if(self.authenticated_role!=OTA_IMAGE_ROLE_NONE)return-EACCES;
 struct legacy_bridge_identity identity={.uid={uid[0],uid[1]},.primary_size=self.output_size};
 memcpy(identity.loader_digest,loader_digest,32);
 memcpy(identity.primary_digest,self.signed_digest,32);
 memcpy(identity.recovery_digest,recovery_digest,32);
 /* A checkpoint belongs to this signed helper, so a future bridge does not
  * accidentally inherit or destroy an older attempt. Full identity is inside. */
 struct bridge_context ctx={0};
 const char prefix[]="vimar/legacy_bridge/";const char hex[]="0123456789abcdef";
 memcpy(ctx.checkpoint_key,prefix,sizeof(prefix)-1);
 for(size_t i=0;i<16;i++){
  ctx.checkpoint_key[sizeof(prefix)-1+i*2]=hex[self.signed_digest[i]>>4];
  ctx.checkpoint_key[sizeof(prefix)+i*2]=hex[self.signed_digest[i]&15];
 }
 const struct legacy_bridge_flow_io io={.ctx=&ctx,.load=load,.save_checkpoint=save_checkpoint,
  .clear_transaction=clear_transaction,.verify_legacy_recovery=verify_legacy_recovery,
  .clear_boot_request=clear_boot};
 return legacy_bridge_flow_prepare(&identity,&io);
}
int legacy_bridge_record_recovery_entry(void)
{
 struct boot_trace trace={0};uint8_t record[BOOT_TRACE_RECORD_SIZE],readback[BOOT_TRACE_RECORD_SIZE];
 ssize_t n=settings_load_one("vimar/boot_trace",record,sizeof(record));
 if(n<0&&n!=-ENOENT)return(int)n;
 if(n>0&&boot_trace_decode(record,(size_t)n,&trace))return-EINVAL;
 /* No final normal MAIN exists yet. Do not inherit a timed CHORD/ZIGBEE entry. */
 boot_trace_request(&trace,BOOT_REASON_OTA_INSTALL);boot_trace_encode(&trace,record);
 int rc=settings_save_one("vimar/boot_trace",record,sizeof(record));
 if(rc)return rc;
 n=settings_load_one("vimar/boot_trace",readback,sizeof(readback));
 return n==(ssize_t)sizeof(record)&&!memcmp(record,readback,sizeof(record))?0:-EIO;
}
```

## src/legacy_bridge_entry_zephyr.h
```c
#ifndef VIMAR_LEGACY_BRIDGE_ENTRY_ZEPHYR_H
#define VIMAR_LEGACY_BRIDGE_ENTRY_ZEPHYR_H
#include <stdint.h>
int legacy_bridge_prepare(const uint32_t uid[2],const uint8_t loader_digest[32],
                          const uint8_t recovery_digest[32]);
int legacy_bridge_record_recovery_entry(void);
#endif
```

## src/legacy_bridge_flow.c
```c
#include "legacy_bridge_flow.h"
#include "ota_transaction.h"
#include <errno.h>
#include <string.h>

static int callback_result(int result)
{
    return result > 0 ? -EIO : result;
}

static int load_record(const struct legacy_bridge_flow_io *io,
                       enum legacy_bridge_key key, uint8_t *record,
                       size_t capacity, size_t *size)
{
    *size = SIZE_MAX;
    int rc = callback_result(io->load(io->ctx, key, record, capacity, size));
    if (rc) return rc;
    return *size > capacity ? -EIO : 0;
}

int legacy_bridge_flow_prepare(const struct legacy_bridge_identity *expected,
                               const struct legacy_bridge_flow_io *io)
{
    uint8_t transaction[OTA_TRANSACTION_MAX_RECORD_SIZE];
    uint8_t checkpoint[LEGACY_BRIDGE_CHECKPOINT_SIZE];
    uint8_t encoded[LEGACY_BRIDGE_CHECKPOINT_SIZE];
    size_t transaction_size, checkpoint_size;
    bool needs_checkpoint, clear_transaction;

    if (!io || !io->load || !io->save_checkpoint || !io->clear_transaction ||
        !io->verify_legacy_recovery || !io->clear_boot_request ||
        legacy_bridge_checkpoint_encode(expected, encoded, sizeof(encoded)))
        return -EINVAL;

    int rc = load_record(io, LEGACY_BRIDGE_TRANSACTION, transaction,
                         sizeof(transaction), &transaction_size);
    if (rc) return rc;
    rc = load_record(io, LEGACY_BRIDGE_CHECKPOINT, checkpoint,
                     sizeof(checkpoint), &checkpoint_size);
    if (rc) return rc;
    if (legacy_bridge_admit(transaction_size ? transaction : NULL, transaction_size,
                            checkpoint_size ? checkpoint : NULL, checkpoint_size,
                            expected, &needs_checkpoint, &clear_transaction))
        return -EPERM;

    if (needs_checkpoint) {
        rc = callback_result(io->verify_legacy_recovery(io->ctx));
        if (rc) return rc;
        rc = callback_result(io->save_checkpoint(io->ctx, encoded, sizeof(encoded)));
        if (rc) return rc;
        rc = load_record(io, LEGACY_BRIDGE_CHECKPOINT, checkpoint,
                         sizeof(checkpoint), &checkpoint_size);
        if (rc) return rc;
        /* Exact equality to the canonical authenticated identity checks every
         * field and CRC, including a successful save that retained wrong bytes. */
        if (checkpoint_size != sizeof(encoded) || memcmp(checkpoint, encoded, sizeof(encoded)))
            return -EIO;
    }

    if (clear_transaction) {
        rc = callback_result(io->clear_transaction(io->ctx));
        if (rc) return rc;
        rc = load_record(io, LEGACY_BRIDGE_TRANSACTION, transaction,
                         sizeof(transaction), &transaction_size);
        if (rc) return rc;
        if (transaction_size) return -EIO;
    }

    return callback_result(io->clear_boot_request(io->ctx));
}
```

## src/legacy_bridge_flow.h
```c
#ifndef VIMAR_LEGACY_BRIDGE_FLOW_H
#define VIMAR_LEGACY_BRIDGE_FLOW_H

#include "legacy_bridge_policy.h"

enum legacy_bridge_key {
    LEGACY_BRIDGE_TRANSACTION,
    LEGACY_BRIDGE_CHECKPOINT,
};

struct legacy_bridge_flow_io {
    void *ctx;
    /* Return 0 and set out_len to 0 for absence. Never return more than capacity
     * bytes. Adapter must normalize its storage API's missing-record result. */
    int (*load)(void *ctx, enum legacy_bridge_key key, uint8_t *record,
                size_t capacity, size_t *out_len);
    int (*save_checkpoint)(void *ctx, const uint8_t *record, size_t size);
    int (*clear_transaction)(void *ctx);
    int (*verify_legacy_recovery)(void *ctx);
    int (*clear_boot_request)(void *ctx);
};

/* Caller authenticates the executing primary, actual full48KiB loader and
 * complete embedded replacement recovery before calling. A fresh checkpoint
 * also requires verify_legacy_recovery to authenticate the current legacy REC.
 * A retained matching checkpoint permits interrupted replacement of that REC.
 *
 * This function only prepares persistent authorization. It never writes REC.
 * Caller may begin the resumable REC copy only after return0. On error it must
 * stop, including when a callback failed after committing its operation. Retry
 * using the same authenticated identity and retained records.
 *
 * All callbacks are required. Negative callback errors propagate; positive
 * statuses are normalized to -EIO. Bad arguments/records return negative errno.
 * The caller must serialize this operation against changes to these records.
 */
int legacy_bridge_flow_prepare(const struct legacy_bridge_identity *expected,
                               const struct legacy_bridge_flow_io *io);

#endif
```

## src/legacy_bridge_policy.c
```c
#include "legacy_bridge_policy.h"
#include "ota_transaction.h"
#include <string.h>

#define CHECKPOINT_MAGIC 0x3143424cu /* LBC1, little endian */
#define CHECKPOINT_VERSION 1u
#define PRIMARY_CAPACITY (0xae000u - 0xc000u)

static void put32(uint8_t *p, uint32_t value)
{
    for (unsigned i = 0; i < 4; ++i) p[i] = (uint8_t)(value >> (8 * i));
}

static uint32_t get32(const uint8_t *p)
{
    uint32_t value = 0;
    for (unsigned i = 0; i < 4; ++i) value |= (uint32_t)p[i] << (8 * i);
    return value;
}

static uint32_t crc32(const uint8_t *record, size_t size)
{
    uint32_t crc = UINT32_MAX;
    for (size_t i = 0; i < size; ++i) {
        crc ^= record[i];
        for (unsigned bit = 0; bit < 8; ++bit)
            crc = (crc >> 1) ^ (0xedb88320u & (0u - (crc & 1u)));
    }
    return ~crc;
}

static bool identity_valid(const struct legacy_bridge_identity *identity)
{
    const uint8_t zero[32] = {0};
    return identity &&
        (identity->uid[0] || identity->uid[1]) &&
        (identity->uid[0] != UINT32_MAX || identity->uid[1] != UINT32_MAX) &&
        identity->primary_size && identity->primary_size <= PRIMARY_CAPACITY &&
        memcmp(identity->loader_digest, zero, 32) &&
        memcmp(identity->primary_digest, zero, 32) &&
        memcmp(identity->recovery_digest, zero, 32);
}

static bool identity_matches(const struct legacy_bridge_identity *left,
                             const struct legacy_bridge_identity *right)
{
    return left->uid[0] == right->uid[0] && left->uid[1] == right->uid[1] &&
        left->primary_size == right->primary_size &&
        !memcmp(left->loader_digest, right->loader_digest, 32) &&
        !memcmp(left->primary_digest, right->primary_digest, 32) &&
        !memcmp(left->recovery_digest, right->recovery_digest, 32);
}

int legacy_bridge_checkpoint_encode(const struct legacy_bridge_identity *identity,
                                    uint8_t *record, size_t size)
{
    if (!identity_valid(identity) || !record || size != LEGACY_BRIDGE_CHECKPOINT_SIZE)
        return -1;
    put32(record, CHECKPOINT_MAGIC);
    put32(record + 4, CHECKPOINT_VERSION);
    put32(record + 8, LEGACY_BRIDGE_CHECKPOINT_SIZE);
    put32(record + 12, 0);
    put32(record + 16, identity->uid[0]);
    put32(record + 20, identity->uid[1]);
    memcpy(record + 24, identity->loader_digest, 32);
    memcpy(record + 56, identity->primary_digest, 32);
    memcpy(record + 88, identity->recovery_digest, 32);
    put32(record + 120, identity->primary_size);
    put32(record + 124, crc32(record, 124));
    return 0;
}

int legacy_bridge_checkpoint_decode(const uint8_t *record, size_t size,
                                    struct legacy_bridge_identity *identity)
{
    if (!identity) return -1;
    memset(identity, 0, sizeof(*identity));
    if (!record || size != LEGACY_BRIDGE_CHECKPOINT_SIZE ||
        get32(record) != CHECKPOINT_MAGIC ||
        get32(record + 4) != CHECKPOINT_VERSION ||
        get32(record + 8) != LEGACY_BRIDGE_CHECKPOINT_SIZE ||
        get32(record + 12) != 0 || get32(record + 124) != crc32(record, 124))
        return -1;
    struct legacy_bridge_identity decoded = {
        .uid = {get32(record + 16), get32(record + 20)},
        .primary_size = get32(record + 120),
    };
    memcpy(decoded.loader_digest, record + 24, 32);
    memcpy(decoded.primary_digest, record + 56, 32);
    memcpy(decoded.recovery_digest, record + 88, 32);
    if (!identity_valid(&decoded)) return -1;
    *identity = decoded;
    return 0;
}

int legacy_bridge_admit(const uint8_t *transaction, size_t transaction_size,
                        const uint8_t *checkpoint, size_t checkpoint_size,
                        const struct legacy_bridge_identity *expected,
                        bool *needs_checkpoint, bool *clear_transaction)
{
    if (needs_checkpoint) *needs_checkpoint = false;
    if (clear_transaction) *clear_transaction = false;
    if (!needs_checkpoint || !clear_transaction || needs_checkpoint == clear_transaction ||
        !identity_valid(expected) ||
        (!transaction != !transaction_size) || (!checkpoint != !checkpoint_size))
        return -1;

    if (checkpoint) {
        struct legacy_bridge_identity retained;
        if (legacy_bridge_checkpoint_decode(checkpoint, checkpoint_size, &retained) ||
            !identity_matches(&retained, expected)) return -1;
    }
    if (!transaction) return checkpoint ? 0 : -1;

    struct ota_transaction decoded;
    if (ota_transaction_decode(transaction, transaction_size, &decoded) ||
        decoded.format_version != OTA_TRANSACTION_VERSION ||
        decoded.state < OTA_TRANSACTION_PENDING || decoded.state > OTA_TRANSACTION_COMPLETE ||
        decoded.signed_image_size != expected->primary_size ||
        memcmp(decoded.final_digest, expected->primary_digest, 32)) return -1;

    *needs_checkpoint = !checkpoint;
    *clear_transaction = true;
    return 0;
}
```

## src/legacy_bridge_policy.h
```c
#ifndef VIMAR_LEGACY_BRIDGE_POLICY_H
#define VIMAR_LEGACY_BRIDGE_POLICY_H

#include <stdbool.h>
#include <stddef.h>
#include <stdint.h>

#define LEGACY_BRIDGE_CHECKPOINT_SIZE 128u

struct legacy_bridge_identity {
    uint32_t uid[2];
    uint8_t loader_digest[32];
    uint8_t primary_digest[32];
    uint8_t recovery_digest[32];
    uint32_t primary_size;
};

/* Checkpoints detect torn storage, not forgery. The caller must independently
 * authenticate the running primary, exact full 48 KiB loader and embedded
 * replacement recovery before using this policy. recovery_digest hashes the
 * complete signed replacement recovery file; primary_digest uses the OTA
 * transaction's authenticated signed-region digest convention.
 *
 * All functions return 0 on success and -1 on invalid arguments/records.
 * Encode leaves its output untouched on failure; decode clears out on failure.
 */
int legacy_bridge_checkpoint_encode(const struct legacy_bridge_identity *identity,
                                    uint8_t *record, size_t size);
int legacy_bridge_checkpoint_decode(const uint8_t *record, size_t size,
                                    struct legacy_bridge_identity *identity);

/* Absence means exactly NULL/0. A present checkpoint must always match expected,
 * even when a valid transaction exists. Flags are cleared before validation.
 * A successful transaction admission requires checkpoint persistence before
 * transaction deletion; this pure policy performs neither operation itself.
 * The absent-transaction path requires an already matching checkpoint.
 */
int legacy_bridge_admit(const uint8_t *transaction, size_t transaction_size,
                        const uint8_t *checkpoint, size_t checkpoint_size,
                        const struct legacy_bridge_identity *expected,
                        bool *needs_checkpoint, bool *clear_transaction);

#endif
```

## src/migration_copy.c
```c
/* SPDX-License-Identifier: Apache-2.0 */
#include "migration_copy.h"
#include "../../ota/ota_image.h"
#include <errno.h>
#include <string.h>

_Alignas(4) static uint8_t expected_page[MIGRATION_PAGE_SIZE];
static uint8_t read_scratch[64];

int migration_common_loader_authorized(const uint8_t actual[32],
                                      const uint8_t allowed[][32], size_t count)
{
    if (!actual || !allowed || !count || count > 64) return -EINVAL;
    for (size_t i = 0; i < count; ++i)
        if (!memcmp(actual, allowed[i], 32)) return 0;
    return -EACCES;
}

int migration_common_recovery_authorized(const struct ota_image_info *authenticated,
                                        size_t embedded_size)
{
    if (!authenticated || embedded_size < 512 + 4 || embedded_size > 0x34000 ||
        authenticated->output_size != embedded_size ||
        authenticated->authenticated_profile != 2 ||
        authenticated->authenticated_role != OTA_IMAGE_ROLE_RECOVERY) return -EACCES;
    return 0;
}

static void prepare_page(const struct migration_copy_bundle *bundle, size_t offset)
{
    memset(expected_page, 0xff, sizeof(expected_page));
    if (offset < bundle->size) {
        size_t count = bundle->size - offset;
        if (count > sizeof(expected_page)) count = sizeof(expected_page);
        memcpy(expected_page, bundle->data + offset, count);
    }
}

/* 0 means exact match, 1 mismatch, negative means operational read error. */
static int compare_page(const struct migration_copy_io *io, uint32_t address)
{
    for (size_t offset = 0; offset < sizeof(expected_page); offset += sizeof(read_scratch)) {
        int rc = io->read(io->ctx, address + (uint32_t)offset, read_scratch,
                          sizeof(read_scratch));
        if (rc) return rc < 0 ? rc : -EIO;
        if (memcmp(read_scratch, expected_page + offset, sizeof(read_scratch))) return 1;
    }
    return 0;
}

int migration_copy_run(const struct migration_copy_bundle *bundle,
                       const struct migration_copy_io *io)
{
    if (!bundle || !io || !bundle->data || bundle->size < 512 + 4 ||
        bundle->size > MIGRATION_RECOVERY_END - MIGRATION_RECOVERY_START ||
        !io->read_uid || !io->sha256 || !io->verify_image || !io->read ||
        !io->erase || !io->write) return -EINVAL;

    uint32_t actual_uid[2];
    int rc = io->read_uid(io->ctx, actual_uid);
    if (rc) return rc < 0 ? rc : -EIO;
    if (actual_uid[0] != bundle->uid[0] || actual_uid[1] != bundle->uid[1]) return -EACCES;

    uint8_t digest[32];
    rc = io->sha256(io->ctx, bundle->data, bundle->size, digest);
    if (rc) return rc < 0 ? rc : -EIO;
    if (memcmp(digest, bundle->sha256, sizeof(digest))) return -EACCES;
    rc = io->verify_image(io->ctx, bundle->data, bundle->size);
    if (rc) return rc < 0 ? rc : -EIO;

    /* The loop constants are the entire write authority. No address or extent
     * from the signed bundle can broaden it into primary, loader or settings. */
    for (uint32_t address = MIGRATION_RECOVERY_START;
         address < MIGRATION_RECOVERY_END; address += MIGRATION_PAGE_SIZE) {
        prepare_page(bundle, address - MIGRATION_RECOVERY_START);
        rc = compare_page(io, address);
        if (rc < 0) return rc;
        if (rc == 0) continue;
        rc = io->erase(io->ctx, address, MIGRATION_PAGE_SIZE);
        if (rc) return rc < 0 ? rc : -EIO;
        rc = io->write(io->ctx, address, expected_page, sizeof(expected_page));
        if (rc) return rc < 0 ? rc : -EIO;
        rc = compare_page(io, address);
        if (rc) return rc < 0 ? rc : -EIO;
    }
    /* Verify complete signed blob AND erased trailing slot, including pages
     * skipped earlier. Success authorizes the caller's recovery reboot only. */
    for (uint32_t address = MIGRATION_RECOVERY_START;
         address < MIGRATION_RECOVERY_END; address += MIGRATION_PAGE_SIZE) {
        prepare_page(bundle, address - MIGRATION_RECOVERY_START);
        rc = compare_page(io, address);
        if (rc) return rc < 0 ? rc : -EIO;
    }
    return 0;
}
```

## src/migration_copy.h
```c
/* SPDX-License-Identifier: Apache-2.0 */
#ifndef VIMAR_MIGRATION_COPY_H
#define VIMAR_MIGRATION_COPY_H
#include <stddef.h>
#include <stdint.h>

#define MIGRATION_RECOVERY_START UINT32_C(0xb0000)
#define MIGRATION_RECOVERY_END UINT32_C(0xf0000)
#define MIGRATION_PAGE_SIZE UINT32_C(4096)

struct migration_copy_bundle {
    uint32_t uid[2]; /* Exact FICR DEVICEID words, in register order. */
    const uint8_t *data; /* Embedded in the authenticated, immutable primary. */
    size_t size;         /* Exact signed recovery extent, excluding erased tail. */
    uint8_t sha256[32];  /* SHA256 of all size bytes, including ordinary TLVs. */
};
struct migration_copy_io {
    void *ctx;
    int (*read_uid)(void *ctx, uint32_t actual_uid[2]);
    int (*sha256)(void *ctx, const uint8_t *data, size_t size, uint8_t digest[32]);
    /* Mandatory: authenticate recovery with the loader's pinned signing key,
     * including complete signed extent == size. Zero success, negative failure.
     * Production wrapper uses ota_image_verify_primary, not a hash-only check. */
    int (*verify_image)(void *ctx, const uint8_t *data, size_t size);
    int (*read)(void *ctx, uint32_t address, uint8_t *out, size_t size);
    int (*erase)(void *ctx, uint32_t address, size_t size);
    int (*write)(void *ctx, uint32_t address, const uint8_t *data, size_t size);
};
struct ota_image_info;
/* Common-mode guards consume a hash of actual FLASH0..0xc000 and metadata
 * published by a successful pinned-key image verifier. Neither grants writes. */
int migration_common_loader_authorized(const uint8_t actual[32],
                                      const uint8_t allowed[][32], size_t count);
int migration_common_recovery_authorized(const struct ota_image_info *authenticated,
                                        size_t embedded_size);
/* Call only from a bootloader-authenticated migration primary. Bundle data and
 * manifest are immutable until return; serialize against BLE and all flash IO.
 * UID/hash/signature are checked on EVERY attempt before any flash mutation.
 * Only recovery pages b0000..f0000 are erased/written. Matching pages are skipped;
 * all bytes after the signed recovery extent are required to be erased (FF).
 * Returns 0 only after final full recovery-range readback; negative error stops
 * immediately. Re-run after failure/reset from the unchanged signed primary.
 * No bootmode changes, persistent flags, reboot or primary invalidation occur.
 * Caller may clear bootmode/reboot only after successful completion.
 * Static page/scratch buffers make this function non-reentrant. */
int migration_copy_run(const struct migration_copy_bundle *bundle,
                       const struct migration_copy_io *io);
#endif
```

## src/migration_policy.c
```c
#include "migration_policy.h"
#include <errno.h>
static int no_set(void*c,uint8_t n){(void)c;(void)n;return 0;}
int migration_protection_preflight(int n,const struct research_handoff_io*io)
{
 if(n>0)return-EBUSY;
 if(n<0&&n!=-ENOENT)return n;
 uint8_t marker;int rc=io->get_marker(io->context,&marker);if(rc)return rc;
 if(!marker)return 0;
 if(marker==RESEARCH_HANDOFF_MARKER){
  struct research_handoff_io peek=*io;peek.set_marker=no_set;int32_t level;
  rc=research_handoff_take(&peek,&level);if(rc<0)return rc;
  if(rc!=1||level!=-32768)return-EPROTONOSUPPORT;
  return io->set_marker(io->context,0);
 }
 struct research_protected_handoff h;rc=research_handoff_peek_protected(io,&h);
 return rc==1?0:rc<0?rc:-EINVAL;
}
```

## src/migration_policy.h
```c
#ifndef VIMAR_MIGRATION_POLICY_H
#define VIMAR_MIGRATION_POLICY_H
#include "research_handoff.h"
/* A missing transaction is0/-ENOENT. Any retained bytes must be resolved before
 * replacing recovery. Legacy ON lacks protection authorization: reject without
 * consuming it; legacy OFF can be cleared. Protected handoff is only peeked. */
int migration_protection_preflight(int,const struct research_handoff_io*);
#endif
```
