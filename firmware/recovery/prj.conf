## CMakeLists.txt
```
cmake_minimum_required(VERSION 3.20.0)
find_package(Zephyr REQUIRED HINTS $ENV{ZEPHYR_BASE})
project(vimar_recovery)
target_sources(app PRIVATE src/main.c)
if(CONFIG_VIMAR_RECOVERY_BUTTON_EXIT)
  if(CONFIG_IMG_ENABLE_IMAGE_CHECK)
    message(FATAL_ERROR "Recovery button exit requires IMG_ENABLE_IMAGE_CHECK=n: SDK fast path can omit DFU_PENDING")
  endif()
  target_sources(app PRIVATE src/recovery_exit.c src/recovery_exit_control.c src/recovery_primary.c src/recovery_exit_zephyr.c)
  target_include_directories(app PRIVATE ${ZEPHYR_BASE}/subsys/mgmt/mcumgr/grp/img_mgmt/include)
  target_link_libraries(app PRIVATE MCUBOOT_BOOTUTIL)
endif()

if(CONFIG_VIMAR_OTA_INSTALLER)
  target_sources(app PRIVATE src/ota_install.c ../ota/ota_image.c ../ota/ota_format.c ../ota/ota_transaction.c ../ota/ota_storage.c ../ota/ota_split_stage.c ../ota/ota_pair.c)
  target_include_directories(app PRIVATE ../ota)
endif()

if(CONFIG_VIMAR_RECOVERY_SERVICE_MODE)
  target_sources(app PRIVATE src/recovery_session.c ../src/wireless_status_led.c ../src/vimar_led.c)
endif()
if(CONFIG_VIMAR_RECOVERY_PAIRING)
  target_sources(app PRIVATE src/recovery_pairing_zephyr.c ../src/connection_intent_zephyr.c ../src/vimar_buttons.c)
endif()

if(CONFIG_VIMAR_RECOVERY_IDENTITY)
  target_sources(app PRIVATE src/recovery_identity.c src/recovery_identity_zephyr.c)
endif()

if(CONFIG_VIMAR_RECOVERY_BOOT_HISTORY)
  target_sources(app PRIVATE src/recovery_boot_history.c src/recovery_boot_history_zephyr.c)
endif()

if(CONFIG_VIMAR_RECOVERY_MIGRATION_EXEC)
  target_sources(app PRIVATE src/recovery_migration.c src/recovery_migration_zephyr.c src/recovery_migration_preflight_zephyr.c)
endif()

if(CONFIG_VIMAR_P031_PROTECTION)
  target_sources(app PRIVATE ../src/candidate_power_protection.c ../src/vimar_power_protection.c ../src/boot_trace.c ../src/boot_trace_zephyr.c)
  target_include_directories(app PRIVATE ../src ../research/src)
  target_sources(app PRIVATE ../research/src/research_handoff.c)
endif()

if(CONFIG_VIMAR_OTA_SPLIT_STAGING)
  if(NOT VIMAR_OTA_PAIR_BINDINGS_HEADER OR NOT EXISTS "${VIMAR_OTA_PAIR_BINDINGS_HEADER}")
    message(FATAL_ERROR "Split OTA requires frozen authorized pair bindings header")
  endif()
  target_compile_definitions(app PRIVATE VIMAR_OTA_PAIR_BINDINGS_HEADER="${VIMAR_OTA_PAIR_BINDINGS_HEADER}")
endif()

include(${CMAKE_CURRENT_SOURCE_DIR}/../loader_contract/runtime.cmake)
```

## Kconfig
```
mainmenu "Vimar independent BLE recovery"
source "Kconfig.zephyr"

config VIMAR_OTA_INSTALLER
    bool "Enable experimental authenticated compressed OTA installer"
    default n
    help
      Opt in only for the explicitly built OTA recovery pair. Legacy recovery
      and generic provisioning retain BLE recovery without the staged installer
      until physical OTA qualification is complete.

rsource "../Kconfig.protection"

config VIMAR_RECOVERY_BUTTON_EXIT
    bool "Candidate authenticated local exit from recovery"
    default n
    depends on VIMAR_P031_PROTECTION && VIMAR_OTA_INSTALLER
    select GPIO
    select MCUMGR_MGMT_NOTIFICATION_HOOKS
    select MCUMGR_SMP_COMMAND_STATUS_HOOKS
    select MCUMGR_GRP_IMG_STATUS_HOOKS
    select MCUMGR_GRP_IMG_MUTEX
    help
      Require release after boot. Legacy profiles use a five-second two-button
      chord and release; pairing-capable profiles use the shared selector.
      Refuse partial uploads and any primary that fails signature, geometry or
      the current compatible-main role policy. Candidate requires qualification.
      The SDK image-check fast path can omit DFU_PENDING; it must stay disabled
      with this candidate's persistent completion tracking.

config VIMAR_RECOVERY_SERVICE_MODE
    bool "Candidate timed Bluetooth service and indefinite fault recovery"
    default n
    depends on VIMAR_RECOVERY_BUTTON_EXIT && SOC_NRF52840
    help
      Both-button and Zigbee requests select blue/green ordinary Bluetooth,
      returning after 60 seconds of inactivity through the authenticated exit
      gate. Other causes and interrupted writes retain blue/red recovery without
      expiry. Active commands/uploads prevent timeout. Uses only RGB PWM0 and
      a passive protection status read; requires measured paired qualification.

config VIMAR_RECOVERY_PAIRING
    bool "Explicit authenticated Zigbee network replacement"
    default y if VIMAR_RECOVERY_SERVICE_MODE
    depends on VIMAR_RECOVERY_SERVICE_MODE && VIMAR_RECOVERY_MIGRATION_EXEC
    help
      SMP group0x8043 exposes read-only capabilities and explicit WRITE0
      requesting a 120-second Zigbee pairing window. Only an authenticated
      Bluetooth command, validated MAIN and idle complete-image state may
      reserve this transition. Successful command output precedes durable
      intent and deferred MAIN restart. Application settings are retained.

config VIMAR_RECOVERY_IDENTITY
    bool "Authenticated runtime identity for common release packages"
    default y if VIMAR_RECOVERY_SERVICE_MODE
    depends on VIMAR_P031_PROTECTION && VIMAR_OTA_INSTALLER && BT && MCUMGR
    help
      Adds read-only SMP group0x8040 command0 with protocol/model/layout, live
      FICR DEVICEID and protected loader SHA256. It does not authorize writes
      and does not provide cryptographic hardware attestation. SMP permissions
      remain authenticated. A project capability service identifies discovery.

config VIMAR_RECOVERY_BOOT_HISTORY
    bool "Read-only authenticated persisted boot history"
    default y if VIMAR_RECOVERY_SERVICE_MODE
    depends on VIMAR_P031_PROTECTION && BT && MCUMGR
    depends on MCUMGR_TRANSPORT_BT && MCUMGR_TRANSPORT_BT_PERM_RW_AUTHEN
    select MCUMGR_SMP_CBOR_MIN_ENCODING_LEVEL_2
    help
      Adds SMP group0x8041 READ command0 with a mutex snapshot of the existing
      six-entry88-byte boot trace and current storage status. No write handler,
      new persistent record, reset or erase command is added. Raw reset flags
      and pending reasons are observations and do not prove a reset cause.

config VIMAR_RECOVERY_MIGRATION_EXEC
    bool "Explicit authenticated execution of a hash-pinned common migration"
    default y if VIMAR_RECOVERY_SERVICE_MODE
    depends on VIMAR_RECOVERY_BUTTON_EXIT && BT && MCUMGR
    depends on MCUMGR_TRANSPORT_BT && MCUMGR_TRANSPORT_BT_PERM_RW_AUTHEN
    depends on !MCUMGR_TRANSPORT_UART && !MCUMGR_TRANSPORT_RAW_UART
    depends on !MCUMGR_TRANSPORT_UART_ASYNC && !MCUMGR_TRANSPORT_UDP
    depends on !MCUMGR_TRANSPORT_SHELL && !MCUMGR_TRANSPORT_LORAWAN
    depends on !MCUMGR_TRANSPORT_DUMMY && !MCUMGR_TRANSPORT_RAW_DUMMY
    help
      Candidate SMP group0x8042 WRITE0 accepts exactly the signed-region hash
      of an already uploaded, pinned-key authenticated profile2 MIGRATION.
      A successful response precedes deferred revalidation and reset. Normal
      OS reset, physical exit and idle expiry remain MAIN-only. No arbitrary
      role, erase, programming, code-protection exception or legacy fallback.

if VIMAR_P031_PROTECTION
config MCUMGR_MGMT_NOTIFICATION_HOOKS
    default y
config MCUMGR_GRP_OS_RESET_HOOK
    default y
endif
```

## prj.conf
```kconfig
# Dedicated DK BLE updater. MCUboot's firmware-updater mode directs uploads to
# slot0_partition, leaving this slot1 image outside normal update operations.
CONFIG_FLASH=y
CONFIG_DISABLE_FLASH_PATCH=y
CONFIG_FLASH_MAP=y
CONFIG_STREAM_FLASH=y
CONFIG_IMG_MANAGER=y
CONFIG_MCUMGR=y
CONFIG_ZCBOR=y
CONFIG_MCUMGR_GRP_IMG=y
CONFIG_MCUMGR_GRP_OS=y
CONFIG_MCUMGR_TRANSPORT_BT=y
CONFIG_MCUMGR_TRANSPORT_BT_PERM_RW_AUTHEN=y
CONFIG_MCUMGR_TRANSPORT_BT_REASSEMBLY=y
CONFIG_MCUMGR_TRANSPORT_WORKQUEUE_STACK_SIZE=4608
CONFIG_SYSTEM_WORKQUEUE_STACK_SIZE=2304
CONFIG_BT=y
CONFIG_BT_PERIPHERAL=y
CONFIG_BT_DEVICE_NAME="Vimar30805-Rescue"
# Keep existing PC and Android associations; only one may connect at a time.
CONFIG_BT_MAX_PAIRED=8
CONFIG_BT_MAX_CONN=1
CONFIG_BT_KEYS_OVERWRITE_OLDEST=n
CONFIG_BT_SMP=y
CONFIG_BT_FIXED_PASSKEY=y
CONFIG_BT_SETTINGS=y
CONFIG_SETTINGS=y
CONFIG_SETTINGS_NVS=y
CONFIG_NVS=y
CONFIG_BT_L2CAP_TX_MTU=247
CONFIG_BT_BUF_ACL_RX_SIZE=251
CONFIG_BT_BUF_ACL_TX_SIZE=251
CONFIG_BT_CTLR_DATA_LENGTH_MAX=251
CONFIG_LOG=y
CONFIG_LOG_DEFAULT_LEVEL=3
CONFIG_USE_SEGGER_RTT=y
CONFIG_SEGGER_RTT_INIT_MODE_ALWAYS=y
CONFIG_LOG_BACKEND_RTT=y
CONFIG_LOG_BACKEND_UART=n
CONFIG_CONSOLE=n
CONFIG_UART_CONSOLE=n
CONFIG_LTO=y
CONFIG_ISR_TABLES_LOCAL_DECLARATION=y
```

## migration-exec.conf
```kconfig
CONFIG_MCUBOOT_SIGNATURE_KEY_FILE=""
CONFIG_MCUBOOT_GENERATE_UNSIGNED_IMAGE=n
CONFIG_BOOTLOADER_MCUBOOT=y
CONFIG_MCUBOOT_BOOTLOADER_MODE_FIRMWARE_UPDATER=y
CONFIG_VIMAR_P031_PROTECTION=y
CONFIG_VIMAR_RECOVERY_BUTTON_EXIT=y
CONFIG_VIMAR_RECOVERY_SERVICE_MODE=y
CONFIG_VIMAR_RECOVERY_IDENTITY=y
CONFIG_VIMAR_OTA_SPLIT_STAGING=y
CONFIG_IMG_ENABLE_IMAGE_CHECK=n
CONFIG_VIMAR_RECOVERY_BOOT_HISTORY=y

CONFIG_VIMAR_RECOVERY_MIGRATION_EXEC=y
```

## src/main.c
```c
#include <zephyr/bluetooth/bluetooth.h>
#include <zephyr/bluetooth/conn.h>
#include <zephyr/kernel.h>
#if defined(CONFIG_VIMAR_RECOVERY_PAIRING)
#include "recovery_pairing.h"
#endif
#include <zephyr/logging/log.h>
#include <zephyr/mgmt/mcumgr/transport/smp_bt.h>
#include <zephyr/settings/settings.h>
#if defined(CONFIG_VIMAR_RECOVERY_IDENTITY)
#include "recovery_identity.h"
#endif
#if defined(CONFIG_VIMAR_RECOVERY_BOOT_HISTORY)
#include "recovery_boot_history.h"
#endif
#if defined(CONFIG_VIMAR_RECOVERY_MIGRATION_EXEC)
#include "recovery_migration.h"
#endif
#if defined(CONFIG_VIMAR_RECOVERY_BUTTON_EXIT)
#include "recovery_exit_zephyr.h"
#endif
#if defined(CONFIG_VIMAR_P031_PROTECTION)
#include "vimar_power_protection.h"
#include "boot_trace.h"
#endif
#if defined(CONFIG_VIMAR_OTA_INSTALLER)
#include "ota_install.h"
#endif

#if defined(CONFIG_VIMAR_P031_PROTECTION)
#include <zephyr/mgmt/mcumgr/mgmt/callbacks.h>
#include <zephyr/mgmt/mcumgr/mgmt/mgmt.h>
#include <zephyr/mgmt/mcumgr/grp/os_mgmt/os_mgmt_callbacks.h>
static enum mgmt_cb_return before_smp_reset(uint32_t event,enum mgmt_cb_return previous,
    int32_t *rc,uint16_t *group,bool *abort_more,void *data,size_t size)
{
 ARG_UNUSED(event);ARG_UNUSED(group);ARG_UNUSED(data);ARG_UNUSED(size);
 if(previous!=MGMT_CB_OK)return previous;
#if defined(CONFIG_VIMAR_RECOVERY_BUTTON_EXIT)
 int error=recovery_exit_zephyr_prepare_reset();
#else
 int error=vimar_power_protection_flush();
#endif
 if(error){
  *rc=MGMT_ERR_EBUSY;*abort_more=true;return MGMT_CB_ERROR_RC;
 }
 return MGMT_CB_OK;
}
static struct mgmt_callback reset_callback={.callback=before_smp_reset,.event_id=MGMT_EVT_OP_OS_MGMT_RESET};
#endif

LOG_MODULE_REGISTER(vimar_recovery, LOG_LEVEL_INF);

static struct k_work advertise_work;
static const struct bt_data advertising_data[] = {
	BT_DATA_BYTES(BT_DATA_FLAGS, BT_LE_AD_GENERAL | BT_LE_AD_NO_BREDR),
	BT_DATA_BYTES(BT_DATA_UUID128_ALL, SMP_BT_SVC_UUID_VAL),
};
static const struct bt_data scan_response[] = {
#if defined(CONFIG_VIMAR_RECOVERY_IDENTITY)
	/* 18-byte project UUID + 12-byte shortened name fit the 31-byte response.
	 * Keep generic SMP UUID in advertising for existing exact-address clients. */
	BT_DATA_BYTES(BT_DATA_UUID128_ALL,
		BT_UUID_128_ENCODE(0x7b2f3080,0x5c91,0x4a6d,0x9f22,0x4e8c6d300805)),
	BT_DATA(BT_DATA_NAME_SHORTENED, "Vimar30805", 10),
#else
	BT_DATA(BT_DATA_NAME_COMPLETE, CONFIG_BT_DEVICE_NAME,
		sizeof(CONFIG_BT_DEVICE_NAME) - 1),
#endif
};

static void advertise(struct k_work *work)
{
	ARG_UNUSED(work);
	int error = bt_le_adv_start(BT_LE_ADV_CONN_FAST_1, advertising_data,
		ARRAY_SIZE(advertising_data), scan_response, ARRAY_SIZE(scan_response));
	if (error != 0) {
		LOG_ERR("Recovery advertising failed: %d", error);
	}
}

static void connected(struct bt_conn *connection, uint8_t error)
{
	ARG_UNUSED(connection);
	if (error != 0) {
		k_work_submit(&advertise_work);
	}
}

static void recycled(void)
{
	k_work_submit(&advertise_work);
}

static void disconnected(struct bt_conn *connection, uint8_t reason)
{
 ARG_UNUSED(connection);ARG_UNUSED(reason);
#if defined(CONFIG_VIMAR_RECOVERY_BUTTON_EXIT)
 recovery_exit_zephyr_disconnected();
#endif
}

BT_CONN_CB_DEFINE(connection_callbacks) = {
	.connected = connected,
	.disconnected = disconnected,
	.recycled = recycled,
};

int main(void)
{
#if defined(CONFIG_VIMAR_OTA_INSTALLER) || defined(CONFIG_VIMAR_P031_PROTECTION)
    int init_result=settings_subsys_init();
#endif
#if defined(CONFIG_VIMAR_P031_PROTECTION)
    if(init_result)LOG_ERR("Recovery settings init: %d",init_result);
    int protection_error=vimar_power_protection_init();
    if(init_result||protection_error)vimar_power_protection_latch_input_failure();
    if(protection_error)LOG_ERR("P0.31 checkpoint unavailable; output inhibited: %d",protection_error);
    int trace_error=vimar_boot_trace_begin(BOOT_IMAGE_RECOVERY);
    if(trace_error)LOG_ERR("Recovery entry checkpoint unavailable: %d",trace_error);
    mgmt_callback_register(&reset_callback);
#endif
#if defined(CONFIG_VIMAR_OTA_INSTALLER)
    /* Direct OTA key reads need the backend, not BT settings before bt_enable. */
    int ota_result=init_result;
    if(!init_result){ota_result=ota_install_pending();if(ota_result)LOG_ERR("OTA install stopped; BLE recovery available: %d",ota_result);}
    else LOG_ERR("OTA settings unavailable: %d",init_result);
#endif
	/* Public development credential, matching the existing DK BLE profile. */
	int error = bt_passkey_set(824005);
	if (error != 0) {
		LOG_ERR("Development passkey setup failed: %d", error);
		return 0;
	}
	error = bt_enable(NULL);
	if (error != 0) {
		LOG_ERR("Recovery Bluetooth failed: %d", error);
		return 0;
	}
	error = settings_load();
	if (error != 0) {
		/* Recovery must remain reachable even if persisted settings are bad.
		 * A client may need to forget its old bond and pair again. */
		LOG_WRN("Recovery settings load failed: %d", error);
	}
#if defined(CONFIG_VIMAR_RECOVERY_BUTTON_EXIT)
	recovery_exit_zephyr_init(init_result?init_result:error, !trace_error && !ota_result);
#endif
#if defined(CONFIG_VIMAR_RECOVERY_IDENTITY)
	recovery_identity_register();
#endif
#if defined(CONFIG_VIMAR_RECOVERY_BOOT_HISTORY)
	recovery_boot_history_register();
#endif
#if defined(CONFIG_VIMAR_RECOVERY_MIGRATION_EXEC)
	recovery_migration_register();
#endif
#if defined(CONFIG_VIMAR_RECOVERY_PAIRING)
    recovery_pairing_register();
#endif
	k_work_init(&advertise_work, advertise);
	k_work_submit(&advertise_work);
	return 0;
}
```

## src/ota_install.c
```c
#if defined(CONFIG_VIMAR_P031_PROTECTION)
#include "boot_trace.h"
#include "vimar_power_protection.h"
#endif
/* SPDX-License-Identifier: Apache-2.0 */
#include "ota_install.h"
#include "ota_image.h"
#include "ota_format.h"
#include "ota_stage.h"
#include "ota_storage.h"
#include "ota_split_stage.h"
#include "ota_pair.h"
#if defined(CONFIG_VIMAR_LOADER_RUNTIME_V2)
#include "loader_runtime_zephyr.h"
#endif
#include <errno.h>
#include <string.h>

/* Static because Zephyr's recovery main thread stack is intentionally small.
 * Installer runs before BLE starts; decoder and page buffer are non-reentrant. */
_Alignas(4) static uint8_t output_page[OTA_STAGE_PAGE_SIZE];
struct writer {
    const struct ota_install_io *io;
    uint32_t expected_offset, page_address, used, erase_limit;
};
static const uint8_t *mapped_at(const struct ota_install_io *io, uint32_t address) {
    return (const uint8_t *)((uintptr_t)io->mapped + address);
}
static int persist_state(struct ota_transaction *tx, const struct ota_install_io *io,
                         enum ota_transaction_state state) {
    if (tx->generation == UINT32_MAX)
        return -EOVERFLOW;
    struct ota_transaction next = *tx;
    next.generation++;
    next.state = state;
    int rc = io->save(io->ctx, &next);
    if (!rc)
        *tx = next;
    return rc;
}
static int flush_page(struct writer *w) {
    if (!w->used)
        return 0;
    if (w->page_address < OTA_PRIMARY_START || w->page_address > w->erase_limit ||
        OTA_STAGE_PAGE_SIZE > w->erase_limit - w->page_address)
        return -EFBIG;
    int rc = w->io->erase(w->io->ctx, w->page_address, OTA_STAGE_PAGE_SIZE);
    if (!rc)
        rc = w->io->write(w->io->ctx, w->page_address, output_page, OTA_STAGE_PAGE_SIZE);
    if (!rc) {
        w->page_address += OTA_STAGE_PAGE_SIZE;
        w->used = 0;
        memset(output_page, 0xff, sizeof(output_page));
    }
    return rc;
}
static int output(void *ctx, uint32_t offset, const uint8_t *data, size_t size) {
    struct writer *w = ctx;
    if (offset != w->expected_offset || size > UINT32_MAX - w->expected_offset)
        return -EINVAL;
    while (size) {
        size_t copy = OTA_STAGE_PAGE_SIZE - w->used;
        if (copy > size)
            copy = size;
        memcpy(output_page + w->used, data, copy);
        w->used += copy;
        w->expected_offset += copy;
        data += copy;
        size -= copy;
        if (w->used == OTA_STAGE_PAGE_SIZE) {
            int rc = flush_page(w);
            if (rc)
                return rc;
        }
    }
    return 0;
}
static int primary_matches(const struct ota_install_io *io, const struct ota_image_info *image,
                           uint32_t capacity) {
    uint8_t digest[32];
    uint32_t region = 0, total = 0;
    const uint8_t *primary = mapped_at(io, OTA_PRIMARY_START);
    if (ota_primary_extent(primary, capacity, &region, &total) || total != image->output_size)
        return 0;
    if (ota_image_sha256(primary, total, digest) || memcmp(digest, image->output_digest, 32))
        return 0;
    if (ota_image_sha256(primary, region, digest) || memcmp(digest, image->signed_digest, 32))
        return 0;
    return 1;
}
static int version_compare(const uint8_t a[8], const uint8_t b[8]) {
    /* MCUboot version components, not bytewise comparison of LE fields. */
    uint32_t av[4] = {a[0], a[1], a[2] | (uint32_t)a[3] << 8,
                      a[4] | (uint32_t)a[5] << 8 | (uint32_t)a[6] << 16 | (uint32_t)a[7] << 24};
    uint32_t bv[4] = {b[0], b[1], b[2] | (uint32_t)b[3] << 8,
                      b[4] | (uint32_t)b[5] << 8 | (uint32_t)b[6] << 16 | (uint32_t)b[7] << 24};
    for (unsigned i = 0; i < 4; i++) {
        if (av[i] != bv[i])
            return av[i] > bv[i] ? 1 : -1;
    }
    return 0;
}
struct split_input {const struct ota_install_io *io;struct ota_split_bounds bounds;};
static int read_split(void*ctx,uint32_t off,uint8_t*p,size_t n) {
 struct split_input *s=ctx;
 while(n){uint32_t physical,available;int rc=ota_split_map(&s->bounds,off,&physical,&available);if(rc)return rc;
  size_t take=n<available?n:available;
  if(physical>s->io->mapped_size||take>s->io->mapped_size-physical)return-EINVAL;
  memcpy(p,mapped_at(s->io,physical),take);off+=take;p+=take;n-=take;}
 return 0;
}
int ota_install_run(struct ota_transaction *tx, const struct ota_install_io *io) {
    if (!tx || !io || !io->erase || !io->write || !io->save || io->mapped_size < OTA_STAGE_END)
        return -EINVAL;
    if (ota_transaction_validate(tx))
        return -EINVAL;
#if defined(CONFIG_VIMAR_OTA_SPLIT_STAGING)
    if(tx->format_version!=2)return-EPROTONOSUPPORT;
#elif !defined(OTA_INSTALL_HOST)
    if(tx->format_version!=1)return-EPROTONOSUPPORT;
#endif
    if (tx->state == OTA_TRANSACTION_DOWNLOADING || tx->state == OTA_TRANSACTION_COMPLETE)
        return 0;
    /* Reserve both durable state transitions before touching primary. */
    if (tx->generation > UINT32_MAX - 2)
        return -EOVERFLOW;
    uint32_t capacity = tx->stage_start - OTA_PRIMARY_START;
    const uint8_t *source = mapped_at(io, tx->stage_start);
    struct ota_image_info image;
    struct split_input input={.io=io,.bounds={tx->stage_start,tx->stage_end,tx->second_start,tx->second_end,tx->candidate_size}};
    struct ota_reader reader={.size=tx->candidate_size,.profile=2,.ctx=&input,.read=read_split};
    if(tx->format_version==2){
#if !defined(CONFIG_VIMAR_OTA_SPLIT_STAGING) && !defined(OTA_INSTALL_HOST)
     return-ENOTSUP;
#endif
     uint8_t loader[32];struct ota_image_info recovery;
     /* JournalV2 remains exact full48KiB; typed authority is independent. */
#if defined(CONFIG_VIMAR_LOADER_RUNTIME_V2)
     int pair_rc=loader_pair_verify_zephyr(tx->recovery_digest,loader,&recovery);
#else
     int pair_rc=ota_pair_verify(io->mapped,io->mapped_size,io->allowed_loaders,io->allowed_loader_count,tx->recovery_digest,loader,&recovery);
#endif
     if(pair_rc)return pair_rc;
     if(memcmp(loader,tx->loader_digest,32))return-EACCES;
     if(ota_split_validate(&input.bounds))return-EINVAL;
    }
    int rc = tx->format_version==2?ota_image_validate_reader(&reader,capacity,&image):ota_image_validate(source, tx->candidate_size, capacity, &image);
    if (rc)
        return rc;
    if (image.output_size != tx->signed_image_size ||
        memcmp(image.source_digest, tx->candidate_digest, 32) ||
        memcmp(image.signed_digest, tx->final_digest, 32))
        return -EACCES;
    /* Power may have failed after valid primary readback but before COMPLETE.
     * Match against independently authenticated reconstruction, never a journal
     * hash alone. This avoids re-erasing an already completed update. */
    if (primary_matches(io, &image, capacity)) {
        rc = persist_state(tx, io, OTA_TRANSACTION_COMPLETE);
        return rc ? rc : 1;
    }
    struct ota_image_info current;
    /* A retained authenticated primary is authoritative for antirollback. A
     * partially erased primary cannot authenticate and may be resumed. Exact
     * completed-candidate recognition above intentionally precedes this check. */
    int current_rc = tx->format_version==2?ota_image_verify_primary_for_profile(mapped_at(io,OTA_PRIMARY_START),capacity,2,&current):ota_image_verify_primary(mapped_at(io, OTA_PRIMARY_START), capacity, &current);
    /* A target/profile mismatch is not evidence of interrupted installation.
     * Independently authenticate the other profile before admitting a replay. */
    if(current_rc==-EACCES){
        struct ota_image_info opposite;
        int other=ota_image_verify_primary_for_profile(mapped_at(io,OTA_PRIMARY_START),capacity,tx->format_version==2?1:2,&opposite);
        if(!other)return-EPROTONOSUPPORT;
        if(other!=-EBADMSG&&other!=-EACCES)return other;
    }
    if (current_rc == 0 && version_compare(image.image_version, current.image_version) <= 0)
        return -EPERM;
    /* Crypto backend/resource failures are not proof of an invalid partial
     * primary and must never disable the version gate. */
    if (current_rc && current_rc != -EBADMSG && current_rc != -EACCES)
        return current_rc;
    rc = persist_state(tx, io, OTA_TRANSACTION_INSTALLING);
    if (rc)
        return rc;
    struct writer w = {.io = io, .page_address = OTA_PRIMARY_START, .erase_limit = tx->stage_start};
    memset(output_page, 0xff, sizeof(output_page));
    /* reconstruct repeats source authentication and full dry run before its
     * first output callback. Interrupted installs always replay from byte zero. */
    rc = tx->format_version==2?ota_image_reconstruct_reader(&reader,capacity,output,&w,&image):ota_image_reconstruct(source, tx->candidate_size, capacity, output, &w, &image);
    if (rc)
        return rc;
    if (w.expected_offset != tx->signed_image_size)
        return -EBADMSG;
    rc = flush_page(&w);
    if (rc)
        return rc;
    if (!primary_matches(io, &image, capacity))
        return -EIO;
    rc = persist_state(tx, io, OTA_TRANSACTION_COMPLETE);
    return rc ? rc : 1;
}

#ifndef OTA_INSTALL_HOST
#include <zephyr/device.h>
#if defined(CONFIG_VIMAR_OTA_SPLIT_STAGING)
#include VIMAR_OTA_PAIR_BINDINGS_HEADER
#endif
#include <zephyr/drivers/flash.h>
#include <zephyr/retention/bootmode.h>
#include <zephyr/sys/reboot.h>
#include <zephyr/logging/log.h>
LOG_MODULE_REGISTER(vimar_ota_install, LOG_LEVEL_INF);
static const struct device *flash_device;
static int device_erase(void *ctx, uint32_t address, size_t size) {
    (void)ctx;
    return flash_erase(flash_device, address, size);
}
static int device_write(void *ctx, uint32_t address, const uint8_t *data, size_t size) {
    (void)ctx;
    return flash_write(flash_device, address, data, size);
}
static int device_save(void *ctx, const struct ota_transaction *tx) {
    (void)ctx;
    return ota_storage_save(tx);
}
int ota_install_pending(void) {
    struct ota_transaction tx;
    int rc = ota_storage_load(&tx);
    if (rc == -ENOENT || rc == -EINVAL)
        return 0;
    if (rc)
        return rc;
    if (tx.state == OTA_TRANSACTION_DOWNLOADING || tx.state == OTA_TRANSACTION_COMPLETE)
        return 0;
    flash_device = DEVICE_DT_GET(DT_CHOSEN(zephyr_flash_controller));
    if (!device_is_ready(flash_device))
        return -ENODEV;
    const struct ota_install_io io = {.mapped = (const uint8_t *)0,
                                      .mapped_size = 0x100000,
                                      .erase = device_erase,
                                      .write = device_write,
                                      .save = device_save,
#if defined(CONFIG_VIMAR_OTA_SPLIT_STAGING)
                                      .allowed_loaders=ota_allowed_loaders,.allowed_loader_count=ota_allowed_loader_count,
#endif
                                      };
    LOG_INF("Checking staged OTA image at 0x%x (%u bytes)", tx.stage_start, tx.candidate_size);
    rc = ota_install_run(&tx, &io);
    if (rc == 1) {
        LOG_INF("OTA installed and verified (%u bytes)", tx.signed_image_size);
        rc = bootmode_clear();
        if (rc)
            return rc;
#if defined(CONFIG_VIMAR_P031_PROTECTION)
        (void)vimar_boot_trace_request(BOOT_REASON_OTA_COMPLETE);
        int protection_rc=vimar_power_protection_flush();
        if(protection_rc)return protection_rc;
#endif
        sys_reboot(SYS_REBOOT_COLD);
        return -EIO;
    }
    if (rc)
        LOG_ERR("OTA install stopped (%d); starting BLE recovery", rc);
    return rc;
}
#endif
```

## src/ota_install.h
```c
/* SPDX-License-Identifier: Apache-2.0 */
#ifndef VIMAR_OTA_INSTALL_H
#define VIMAR_OTA_INSTALL_H
#include <stddef.h>
#include <stdint.h>
#include "ota_transaction.h"

struct ota_install_io {
    /* Contiguous memory-mapped flash, indexed by physical flash address. On
     * nRF52840 mapped is address zero. Host tests use a RAM buffer. */
    const uint8_t *mapped;
    size_t mapped_size;
    void *ctx;
    int (*erase)(void *ctx, uint32_t address, size_t size);
    int (*write)(void *ctx, uint32_t address, const uint8_t *data, size_t size);
    int (*save)(void *ctx, const struct ota_transaction *tx);
    const uint8_t (*allowed_loaders)[32];
    size_t allowed_loader_count;
};
/* Serialized early-boot operation. Returns 1 after persisted completion, zero
 * for inactive transactions, negative error. No IO occurs before dry-run auth.
 * Source, destination and journal must remain exclusively owned for this call. */
int ota_install_run(struct ota_transaction *tx, const struct ota_install_io *io);
/* After settings initialization/load, before starting BLE services. Reboots on
 * successful install; errors return so authenticated BLE recovery can start. */
int ota_install_pending(void);
#endif
```

## src/recovery_boot_history.c
```c
#include "recovery_boot_history.h"

bool recovery_boot_history_encode(zcbor_state_t *s,const struct boot_trace_history *h)
{
 if(!s||!h||h->view.count>BOOT_TRACE_ENTRIES||h->view.pending_reason>BOOT_REASON_BOOT_SELECTOR)return false;
 for(unsigned i=0;i<h->view.count;i++)
  if(h->view.entries[i].image>BOOT_IMAGE_RECOVERY||h->view.entries[i].reason>BOOT_REASON_BOOT_SELECTOR)return false;
 if(!(zcbor_tstr_put_lit(s,"protocol")&&zcbor_uint32_put(s,1)&&
      zcbor_tstr_put_lit(s,"record_size")&&zcbor_uint32_put(s,BOOT_TRACE_RECORD_SIZE)&&
      zcbor_tstr_put_lit(s,"capacity")&&zcbor_uint32_put(s,BOOT_TRACE_ENTRIES)&&
      zcbor_tstr_put_lit(s,"current_image")&&zcbor_uint32_put(s,BOOT_IMAGE_RECOVERY)&&
      zcbor_tstr_put_lit(s,"sequence")&&zcbor_uint32_put(s,h->view.sequence)&&
      zcbor_tstr_put_lit(s,"pending_reason")&&zcbor_uint32_put(s,h->view.pending_reason)&&
      zcbor_tstr_put_lit(s,"state")&&zcbor_map_start_encode(s,7)&&
      zcbor_tstr_put_lit(s,"initialized")&&zcbor_bool_put(s,h->initialized)&&
      zcbor_tstr_put_lit(s,"loaded_valid")&&zcbor_bool_put(s,h->loaded_valid)&&
      zcbor_tstr_put_lit(s,"storage_valid")&&zcbor_bool_put(s,h->storage_valid)&&
      zcbor_tstr_put_lit(s,"load_rc")&&zcbor_int32_put(s,h->load_result)&&
      zcbor_tstr_put_lit(s,"decode_rc")&&zcbor_int32_put(s,h->decode_result)&&
      zcbor_tstr_put_lit(s,"save_rc")&&zcbor_int32_put(s,h->save_result)&&
      zcbor_tstr_put_lit(s,"view_rc")&&zcbor_int32_put(s,h->view_result)&&
      zcbor_map_end_encode(s,7)&&zcbor_tstr_put_lit(s,"entries")&&
      zcbor_list_start_encode(s,BOOT_TRACE_ENTRIES)))return false;
 for(unsigned i=0;i<h->view.count;i++){
  const struct boot_trace_entry *e=&h->view.entries[i];
  if(!(zcbor_map_start_encode(s,4)&&zcbor_tstr_put_lit(s,"seq")&&zcbor_uint32_put(s,e->sequence)&&
       zcbor_tstr_put_lit(s,"image")&&zcbor_uint32_put(s,e->image)&&
       zcbor_tstr_put_lit(s,"reason")&&zcbor_uint32_put(s,e->reason)&&
       zcbor_tstr_put_lit(s,"raw_reset_flags")&&zcbor_uint32_put(s,e->reset_flags)&&
       zcbor_map_end_encode(s,4)))return false;
 }
 return zcbor_list_end_encode(s,BOOT_TRACE_ENTRIES);
}
```

## src/recovery_boot_history.h
```c
#ifndef VIMAR_RECOVERY_BOOT_HISTORY_H
#define VIMAR_RECOVERY_BOOT_HISTORY_H
#include <zcbor_encode.h>
#include "boot_trace.h"
#define VIMAR_BOOT_HISTORY_GROUP 0x8041u
bool recovery_boot_history_encode(zcbor_state_t *,const struct boot_trace_history *);
void recovery_boot_history_register(void);
#endif
```

## src/recovery_boot_history_zephyr.c
```c
#include "recovery_boot_history.h"
#include <zephyr/mgmt/mcumgr/mgmt/mgmt.h>
#include <zephyr/mgmt/mcumgr/smp/smp.h>

static int read_history(struct smp_streamer *stream)
{
 struct boot_trace_history history;
 /* One full mutex snapshot. This read path never loads/saves/deletes settings,
  * changes a boot request, clears RESETREAS, erases flash or requests a reset. */
 vimar_boot_trace_history_snapshot(&history);
 return recovery_boot_history_encode(stream->writer->zs,&history)?MGMT_ERR_EOK:MGMT_ERR_EMSGSIZE;
}
static const struct mgmt_handler handlers[]={{.mh_read=read_history}};
static struct mgmt_group group={.mg_handlers=handlers,.mg_handlers_count=1,.mg_group_id=VIMAR_BOOT_HISTORY_GROUP};
void recovery_boot_history_register(void){mgmt_register_group(&group);}
```

## src/recovery_exit.c
```c
#include "recovery_exit.h"
#include <string.h>
void recovery_exit_init(struct recovery_exit *s){memset(s,0,sizeof(*s));}
bool recovery_exit_tick(struct recovery_exit *s,uint32_t now,uint8_t pressed,bool inhibited)
{
 pressed&=3u;
 if(!s->initialized){s->initialized=true;s->raw=pressed;s->raw_since=now;}
 if(s->raw!=pressed){s->raw=pressed;s->raw_since=now;}
 bool debounced=(uint32_t)(now-s->raw_since)>=30;
 if(debounced)s->stable=s->raw;
 if(inhibited){s->ready=false;s->holding=false;s->qualified=false;return false;}
 if(!s->ready){
  if(!pressed&&!s->stable&&debounced)s->ready=true;
  return false;
 }
 if(s->qualified){
  if(!pressed&&!s->stable&&debounced){s->qualified=false;s->holding=false;return true;}
  return false;
 }
 if(pressed!=3u||s->stable!=3u){s->holding=false;return false;}
 if(!s->holding){s->holding=true;s->hold_since=now;}
 if((uint32_t)(now-s->hold_since)>=5000)s->qualified=true;
 return false;
}
```

## src/recovery_exit.h
```c
#ifndef VIMAR_RECOVERY_EXIT_H
#define VIMAR_RECOVERY_EXIT_H
#include <stdbool.h>
#include <stdint.h>
struct recovery_exit {
 bool initialized,ready,holding,qualified;
 uint8_t raw,stable;
 uint32_t raw_since,hold_since;
};
void recovery_exit_init(struct recovery_exit *);
/* Both buttons released after boot, then a continuous five-second chord.
 * Returns once on debounced release after qualification, never while held.
 * Inhibition cancels the gesture and requires another release/new hold. */
bool recovery_exit_tick(struct recovery_exit *,uint32_t now,uint8_t pressed,bool inhibited);
#endif
```

## src/recovery_exit_control.c
```c
#include "recovery_exit_control.h"
#include <errno.h>
#include <string.h>
void recovery_exit_control_init(struct recovery_exit_control *c,ssize_t length,unsigned value)
{
 memset(c,0,sizeof(*c));
 c->partial=length!=0;
 c->durable=length==1&&value==1;
}
int recovery_exit_command_begin(struct recovery_exit_control *c,bool write,const struct recovery_exit_io *io)
{
 if(c->exiting||c->command_busy)return-EBUSY;
 if(write){
  c->partial=true;
  if(!c->durable){
   int rc=io->persist(io->context,true);
   if(rc)return rc;
   c->durable=true;
  }
 }
 /* Publication of command ownership follows successful durable admission.
  * Failed persistence still latches partial, but must not strand diagnostics
  * behind an owner that the adapter never admitted. */
 c->command_busy=true;
 return 0;
}
void recovery_exit_command_done(struct recovery_exit_control *c){c->command_busy=false;}
void recovery_exit_transfer_started(struct recovery_exit_control *c){c->session=true;}
void recovery_exit_transfer_stopped(struct recovery_exit_control *c){c->session=false;}
int recovery_exit_transfer_complete(struct recovery_exit_control *c,const struct recovery_exit_io *io)
{
 c->session=false;
 c->partial=true;
 int rc=io->verify(io->context);
 if(!rc)rc=io->persist(io->context,false);
 if(rc)return rc;
 c->partial=false;c->durable=false;
 return 0;
}
int recovery_exit_attempt(struct recovery_exit_control *c,const struct recovery_exit_io *io)
{
 if(c->partial||c->session||c->command_busy||c->exiting)return-EBUSY;
 int rc=io->verify(io->context);
 if(!rc)rc=io->flush(io->context);
 if(!rc)rc=io->clear_boot(io->context);
 if(rc)return rc;
 c->exiting=true;
 io->reboot(io->context);
 return 0;
}
int recovery_exit_migration_request(struct recovery_exit_control *c,const struct recovery_exit_io *io)
{
 if(!c->command_busy||c->partial||c->session||c->exiting)return-EBUSY;
 int rc=io->verify(io->context);
 if(!rc)rc=io->flush(io->context);
 if(rc)return rc;
 c->exiting=true;c->migration_pending=true;c->migration_ready=false;
 return 0;
}
void recovery_exit_migration_cancel(struct recovery_exit_control *c)
{
 if(!c->migration_pending)return;
 c->migration_pending=false;c->migration_ready=false;c->exiting=false;
}
void recovery_exit_migration_done(struct recovery_exit_control *c,bool output_ok)
{
 if(!c->migration_pending)return;
 if(!output_ok||c->command_busy)recovery_exit_migration_cancel(c);
 else c->migration_ready=true;
}
int recovery_exit_migration_attempt(struct recovery_exit_control *c,const struct recovery_exit_io *io)
{
 if(!c->migration_pending||!c->migration_ready||!c->exiting||c->partial||c->session||c->command_busy)return-EBUSY;
 int rc=io->verify(io->context);
 if(!rc)rc=io->flush(io->context);
 if(!rc)rc=io->clear_boot(io->context);
 if(rc){recovery_exit_migration_cancel(c);return rc;}
 io->reboot(io->context);
 return 0;
}
int recovery_exit_sdk_reset_prepare(struct recovery_exit_control *c,const struct recovery_exit_io *io)
{
 if(!c->command_busy||c->partial||c->session||c->exiting)return-EBUSY;
 int rc=io->verify(io->context);
 if(!rc)rc=io->flush(io->context);
 if(!rc)rc=io->clear_boot(io->context);
 if(rc)return rc;
 /* The SDK may schedule its reset as soon as this returns. Never thaw this
  * fence on command output error or disconnect; only a reboot releases it. */
 c->exiting=true;
 return 0;
}

int recovery_exit_pairing_request(struct recovery_exit_control *c,const struct recovery_exit_io *io)
{
 if(!c->command_busy||c->partial||c->session||c->exiting)return-EBUSY;
 int rc=io->verify(io->context);
 if(!rc)rc=io->flush(io->context);
 if(rc)return rc;
 c->exiting=true;c->pairing_pending=true;c->pairing_ready=false;
 return 0;
}
void recovery_exit_pairing_done(struct recovery_exit_control *c,bool output_ok)
{
 if(!c->pairing_pending)return;
 if(!output_ok||c->command_busy){
  c->pairing_pending=false;c->pairing_ready=false;c->exiting=false;
 }else c->pairing_ready=true;
}
int recovery_exit_pairing_local_request(struct recovery_exit_control *c,const struct recovery_exit_io *io)
{
 int rc=recovery_exit_command_begin(c,false,io);
 if(rc)return rc;
 rc=recovery_exit_pairing_request(c,io);
 recovery_exit_command_done(c);
 if(!rc)recovery_exit_pairing_done(c,true);
 return rc;
}
int recovery_exit_pairing_attempt(struct recovery_exit_control *c,const struct recovery_exit_io *io,int (*request)(void))
{
 if(!c->pairing_pending||!c->pairing_ready||!c->exiting||c->partial||c->session||c->command_busy)return-EBUSY;
 int rc=io->verify(io->context);
 if(!rc)rc=io->flush(io->context);
 if(!rc)rc=io->clear_boot(io->context);
 if(!rc)rc=request();
 if(rc){recovery_exit_pairing_done(c,false);return rc;}
 io->reboot(io->context);return 0;
}
```

## src/recovery_exit_control.h
```c
#ifndef VIMAR_RECOVERY_EXIT_CONTROL_H
#define VIMAR_RECOVERY_EXIT_CONTROL_H
#include <stdbool.h>
#include <sys/types.h>
/* Caller serializes every operation against SMP command admission and image IO. */
struct recovery_exit_control {
 bool partial,durable,session,command_busy,exiting;
 /* exiting without migration_pending belongs to the SDK/ordinary exit and
  * must never be cancelled by RPC output errors or disconnect. */
 bool migration_pending,migration_ready;
 bool pairing_pending,pairing_ready;
};
struct recovery_exit_io {
 void *context;
 int (*persist)(void *,bool);
 int (*verify)(void *);
 int (*flush)(void *);
 int (*clear_boot)(void *);
 void (*reboot)(void *);
};
void recovery_exit_control_init(struct recovery_exit_control *,ssize_t,unsigned);
int recovery_exit_command_begin(struct recovery_exit_control *,bool,const struct recovery_exit_io *);
void recovery_exit_command_done(struct recovery_exit_control *);
void recovery_exit_transfer_started(struct recovery_exit_control *);
void recovery_exit_transfer_stopped(struct recovery_exit_control *);
int recovery_exit_transfer_complete(struct recovery_exit_control *,const struct recovery_exit_io *);
int recovery_exit_attempt(struct recovery_exit_control *,const struct recovery_exit_io *);
int recovery_exit_migration_request(struct recovery_exit_control *,const struct recovery_exit_io *);
void recovery_exit_migration_done(struct recovery_exit_control *,bool output_ok);
void recovery_exit_migration_cancel(struct recovery_exit_control *);
int recovery_exit_migration_attempt(struct recovery_exit_control *,const struct recovery_exit_io *);
int recovery_exit_sdk_reset_prepare(struct recovery_exit_control *,const struct recovery_exit_io *);
int recovery_exit_pairing_request(struct recovery_exit_control *,const struct recovery_exit_io *);
int recovery_exit_pairing_local_request(struct recovery_exit_control *,const struct recovery_exit_io *);
void recovery_exit_pairing_done(struct recovery_exit_control *,bool output_ok);
int recovery_exit_pairing_attempt(struct recovery_exit_control *,const struct recovery_exit_io *,int (*request)(void));
#endif
```

## src/recovery_exit_zephyr.h
```c
#ifndef VIMAR_RECOVERY_EXIT_ZEPHYR_H
#define VIMAR_RECOVERY_EXIT_ZEPHYR_H
#include <stdbool.h>
#include <stdint.h>
void recovery_exit_zephyr_init(int settings_error, bool trusted_entry);
void recovery_exit_zephyr_disconnected(void);
/* Called only by the authenticated8042 handler after command admission. */
int recovery_exit_zephyr_migration_request(const uint8_t expected_hash[32]);
/* Called only by authenticated8043 WRITE0 after command admission. */
int recovery_exit_zephyr_pairing_request(void);
int recovery_exit_zephyr_pairing_capable(void);
/* Normal SDK OS reset: signed MAIN, no partial/session, durable checkpoint,
 * boot handoff clear and permanent admission freeze before SDK scheduling. */
int recovery_exit_zephyr_prepare_reset(void);
#endif
```

## src/recovery_identity.c
```c
#include "recovery_identity.h"

bool recovery_identity_encode(zcbor_state_t *s, const uint32_t uid[2], const uint8_t loader_sha256[32])
{
 if(!s||!uid||!loader_sha256)return false;
 return zcbor_tstr_put_lit(s,"protocol")&&zcbor_uint32_put(s,1)&&
  zcbor_tstr_put_lit(s,"model")&&zcbor_tstr_put_lit(s,"VIMAR30805")&&
  zcbor_tstr_put_lit(s,"layout")&&zcbor_uint32_put(s,2)&&
  zcbor_tstr_put_lit(s,"uid")&&zcbor_list_start_encode(s,2)&&
  zcbor_uint32_put(s,uid[0])&&zcbor_uint32_put(s,uid[1])&&zcbor_list_end_encode(s,2)&&
  zcbor_tstr_put_lit(s,"loader_sha256")&&
  zcbor_bstr_encode_ptr(s,(const char*)loader_sha256,32);
}
```
