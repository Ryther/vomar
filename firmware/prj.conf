## CMakeLists.txt
```
cmake_minimum_required(VERSION 3.20.0)
find_package(Zephyr REQUIRED HINTS $ENV{ZEPHYR_BASE})
project(vimar_30805_platform)

target_sources(app PRIVATE
    src/main.c
    src/dimmer_config.c
    src/phase_cut_control.c
    src/dimmer_model.c
    src/gesture_classifier.c
    src/local_action_mapper.c
    src/led_controller.c
    src/settings_record.c
    src/settings_store.c
    src/app_settings_backend.c
    src/application_controller.c
    src/zigbee_custom_codec.c
    src/ota_runtime_contract.c
    src/zigbee_device.c
    src/zigbee_report_policy.c
    src/wireless_status_led.c
    src/connection_pairing.c
    src/connection_capability.c
    src/connection_intent_zephyr.c
    src/zboss_mem_globals.c
)

target_include_directories(app PRIVATE src)
zephyr_link_libraries(-Wl,--undefined=vimar_connection_pairing_capability)

if(CONFIG_LTO)
    set_source_files_properties(src/zboss_mem_globals.c PROPERTIES COMPILE_OPTIONS -fno-lto)
endif()

if(CONFIG_ZBOSS_RESET_ON_ASSERT)
    # The pinned SDK fatal reset writes SYS_REBOOT_COLD=1 into GPREGRET1,
    # colliding with MCUboot's BOOTLOADER=1. Wrap only its external abort entry.
    # Keep the SDK translation unit outside LTO so calls cannot inline the
    # original register write before the linker applies --wrap.
    set(vimar_zb_platform "${ZEPHYR_NCS_ZIGBEE_MODULE_DIR}/subsys/osif/zb_nrf_platform.c")
    if(NOT EXISTS "${vimar_zb_platform}" OR NOT TARGET ..__ncs-zigbee__subsys)
        message(FATAL_ERROR "Zigbee reset guard requires the pinned ncs-zigbee OSIF target")
    endif()
    file(SHA256 "${vimar_zb_platform}" vimar_zb_platform_sha256)
    if(NOT vimar_zb_platform_sha256 STREQUAL "6dda587ed95c3c7bdc4d810907b2afe06ab63526e76510abf8799e7f0ad8de8f")
        message(FATAL_ERROR "Zigbee reset guard requires review of the changed SDK reset path")
    endif()
    set_property(SOURCE "${vimar_zb_platform}" TARGET_DIRECTORY ..__ncs-zigbee__subsys
        APPEND PROPERTY COMPILE_OPTIONS -fno-lto)
    target_sources(app PRIVATE src/zigbee_reset_guard.c)
    set_source_files_properties(src/zigbee_reset_guard.c PROPERTIES COMPILE_OPTIONS -fno-lto)
    zephyr_link_libraries(-Wl,--wrap=zb_osif_abort)
endif()

if(CONFIG_VIMAR_FAULT_DIAGNOSTICS)
    if(NOT VIMAR_FAULT_BUILD_ID_HEADER OR NOT EXISTS "${VIMAR_FAULT_BUILD_ID_HEADER}")
        message(FATAL_ERROR "Fault capture requires an immutable generated build ID")
    endif()
    target_sources(app PRIVATE src/fault_diag.c src/fault_diag_zephyr.c src/fault_diag_sdk.c)
    target_compile_definitions(app PRIVATE VIMAR_FAULT_BUILD_ID_HEADER="${VIMAR_FAULT_BUILD_ID_HEADER}")
    set(vimar_zb_error_include "${ZEPHYR_NCS_ZIGBEE_MODULE_DIR}/lib/zboss/src/include")
    set(vimar_zb_error_api "${vimar_zb_error_include}/zboss_api_error.h")
    if(NOT EXISTS "${vimar_zb_error_api}")
        message(FATAL_ERROR "Fault capture requires the pinned SDK error API")
    endif()
    file(SHA256 "${vimar_zb_error_api}" vimar_zb_error_api_sha)
    if(NOT vimar_zb_error_api_sha STREQUAL "5c80ca5d906eb9c53687412a465690f6c6d999b434cd29e9723c10b1dc24a9e1")
        message(FATAL_ERROR "Fault capture requires review of the changed SDK error API")
    endif()
    target_include_directories(app PRIVATE "${vimar_zb_error_include}")
    set(vimar_zb_utils "${ZEPHYR_NCS_ZIGBEE_MODULE_DIR}/subsys/lib/zigbee_app_utils/zigbee_app_utils.c")
    set(vimar_zb_errors "${ZEPHYR_NCS_ZIGBEE_MODULE_DIR}/include/zigbee/zigbee_error_handler.h")
    file(SHA256 "${vimar_zb_utils}" vimar_zb_utils_sha)
    file(SHA256 "${vimar_zb_errors}" vimar_zb_errors_sha)
    if(NOT vimar_zb_utils_sha STREQUAL "58431692bc9461bab199d55353ff56c25d12c9d8530dbfbe6c52b37e83f37fef" OR
       NOT vimar_zb_errors_sha STREQUAL "a5470831abcb5c99ab805d33206c2b668a8e303d7707b8ab01038fd88526320f")
        message(FATAL_ERROR "Fault capture requires review of changed SDK checked-error sites")
    endif()
    set(vimar_diag_hook "${CMAKE_CURRENT_SOURCE_DIR}/src/fault_diag_error_hook.h")
    set_property(SOURCE "${CMAKE_CURRENT_SOURCE_DIR}/src/zigbee_device.c" APPEND PROPERTY
        COMPILE_OPTIONS "-include${vimar_diag_hook}" -DVIMAR_DIAG_ERROR_SITE=1 -fno-lto -fno-optimize-sibling-calls)
    set_property(SOURCE "${vimar_zb_utils}" TARGET_DIRECTORY ..__ncs-zigbee__subsys__lib__zigbee_app_utils APPEND PROPERTY
        COMPILE_OPTIONS "-include${vimar_diag_hook}" -DVIMAR_DIAG_ERROR_SITE=2 -fno-lto -fno-optimize-sibling-calls)
    target_include_directories(..__ncs-zigbee__subsys__lib__zigbee_app_utils PRIVATE "${CMAKE_CURRENT_SOURCE_DIR}/src")
    set_source_files_properties(src/fault_diag.c src/fault_diag_zephyr.c src/fault_diag_sdk.c
        PROPERTIES COMPILE_OPTIONS -fno-lto)
endif()

if(CONFIG_VIMAR_LOOP_TRACE)
    file(SHA256 "${ZEPHYR_BASE}/kernel/fatal.c" vimar_loop_fatal_sha)
    if(NOT vimar_loop_fatal_sha STREQUAL "63a403ccdf73d0961e7a8d3b586e8a06908b1352ce226073434cdef5298fc30f" OR
       CONFIG_RESET_ON_FATAL_ERROR)
        message(FATAL_ERROR "Loop trace requires review of changed kernel fatal policy")
    endif()
    target_sources(app PRIVATE src/loop_trace.c src/loop_trace_zephyr.c src/loop_trace_fatal.c)
    set_source_files_properties(src/loop_trace.c src/loop_trace_zephyr.c src/loop_trace_fatal.c
        PROPERTIES COMPILE_OPTIONS -fno-lto)
endif()

if(CONFIG_VIMAR_HARDWARE)
    target_sources(app PRIVATE src/platform_io_vimar.c src/vimar_identity.c src/vimar_level.c src/vimar_led.c src/vimar_buttons.c src/vimar_attachment.c src/vimar_attachment_gpio.c
        research/src/research_output.c research/src/research_protocol.c research/src/research_handoff.c)
    target_include_directories(app PRIVATE research/src)
else()
    target_sources(app PRIVATE src/platform_io_dk.c)
endif()

if(CONFIG_VIMAR_ZIGBEE_OTA)
target_sources(app PRIVATE src/zigbee_ota.c ota/ota_stage.c ota/ota_transaction.c ota/ota_storage.c ota/ota_format.c ota/ota_image.c ota/ota_split_stage.c ota/ota_pair.c)
target_include_directories(app PRIVATE ota)
target_compile_definitions(app PRIVATE OTA_IMAGE_AUTH_ONLY)
endif()

if(CONFIG_VIMAR_P031_PROTECTION)
  target_sources(app PRIVATE src/candidate_power_protection.c src/vimar_power_protection.c src/boot_trace.c src/boot_trace_zephyr.c)
  target_include_directories(app PRIVATE src research/src)
endif()

if(CONFIG_VIMAR_OTA_SPLIT_STAGING)
  if(NOT VIMAR_OTA_PAIR_BINDINGS_HEADER OR NOT EXISTS "${VIMAR_OTA_PAIR_BINDINGS_HEADER}")
    message(FATAL_ERROR "Split OTA requires frozen authorized pair bindings header")
  endif()
  target_compile_definitions(app PRIVATE VIMAR_OTA_PAIR_BINDINGS_HEADER="${VIMAR_OTA_PAIR_BINDINGS_HEADER}")
endif()

include(${CMAKE_CURRENT_SOURCE_DIR}/loader_contract/runtime.cmake)
include(${CMAKE_CURRENT_SOURCE_DIR}/ownership_guard.cmake)
include(${CMAKE_CURRENT_SOURCE_DIR}/diag_batch.cmake)
```

## Kconfig
```
mainmenu "Vimar configurable Zigbee application"
source "Kconfig.zephyr"
config VIMAR_HARDWARE
    bool "Vimar30805 validated PWM/GPIO adapter (not DK simulation)"
    default n
    depends on SOC_NRF52840
config RESEARCH_STOCK_OUTPUT
    bool
    default y if VIMAR_HARDWARE
config RESEARCH_STOCK_CONFIG19
    int
    range 0 1
    default 0

config VIMAR_ZIGBEE_OTA
    bool "Authenticated compressed Zigbee OTA for Vimar"
    depends on VIMAR_HARDWARE
    default n

config VIMAR_FAULT_DIAGNOSTICS
    bool "Retain exact Zigbee fatal diagnostics across software reset"
    depends on SOC_NRF52840 && ZBOSS_RESET_ON_ASSERT && SETTINGS && !BT
    default n

config VIMAR_ZIGBEE_OWNERSHIP_GUARD
    bool "Experimental native Zigbee transaction ownership guard"
    depends on SOC_NRF52840 && ZIGBEE_ADD_ON
    default n
    help
      Preserve ordinary local transaction ownership at the NWK confirmation
      boundary. Requires the reviewed trace archive or compact native-boundary
      derivation and complete link admission. Host tests do not qualify devices.

config VIMAR_ZIGBEE_DIAGNOSTIC_BATCH
    bool "Experimental counted allocation diagnostic batches"
    depends on VIMAR_ZIGBEE_OWNERSHIP_GUARD && VIMAR_FAULT_DIAGNOSTICS
    default n
    help
      Batch native statistics in RAM and acquire bounded allocation refusals.
      Requires boards/allocation-trace.overlay for the independent retained
      SRAM commits. No error-triggered flash write or unsolicited radio send.
      Aggregate pending allocation failure diagnostics modulo65536 while
      retaining ordinary callbacks and original SDK error handling. Requires
      the reviewed derived SDK archive and complete link admission. Diagnostic
      checkpoints are volatile; other NVRAM callers retain normal persistence.
      Target timing and hardware behavior remain unqualified.

config VIMAR_ALLOC_TRACE
    bool "Experimental allocation provenance and history capture"
    depends on VIMAR_ZIGBEE_DIAGNOSTIC_BATCH
    default y
    help
      Acquire allocation callers, holder histories and retained SRAM records.
      Disable for the production profile while preserving native forwarding,
      ownership protection and counted allocation diagnostic batching.

config VIMAR_LOOP_TRACE
    bool "Experimental retained application-loop observations"
    depends on VIMAR_FAULT_DIAGNOSTICS
    default n
    help
      Observe callback progression and exact alarm return in reserved SRAM.
      Requires the loop-trace RAM overlay and reviewed kernel halt policy.
      This instrumentation is not a scheduling or physical freeze correction.

rsource "Kconfig.protection"
```

## Kconfig.protection
```
config VIMAR_P031_PROTECTION
    bool "Candidate P0.31 shared output inhibit (paired recovery required)"
    depends on SOC_NRF52840 && SETTINGS
    select GPIO
    select SOC_FLASH_NRF_PARTIAL_ERASE
    default n
    help
      Experimental opt-in for the matching main/recovery pair. Physical input
      meaning and monitoring coverage through flash/reset need qualification.

config VIMAR_OTA_SPLIT_STAGING
    bool "Version2 OTA staging in bounded primary/recovery tails"
    depends on VIMAR_P031_PROTECTION
    default n
    help
      Requires a release-authorized loader allowlist, matched signed recovery,
      exact code limits and separately qualified migration. Legacy stays default.

rsource "loader_contract/Kconfig.runtime"
```

## Kconfig.sysbuild
```
choice FIRMWARE_LOADER
config FIRMWARE_LOADER_IMAGE_VIMAR_BLE
	bool "Vimar authenticated BLE recovery"
endchoice

config FIRMWARE_LOADER_IMAGE_NAME
	default "vimar_recovery" if FIRMWARE_LOADER_IMAGE_VIMAR_BLE

config FIRMWARE_LOADER_IMAGE_PATH
	default "$(APP_DIR)/recovery" if FIRMWARE_LOADER_IMAGE_VIMAR_BLE

source "share/sysbuild/Kconfig"
```

## sysbuild.conf
```
SB_CONFIG_BOOTLOADER_MCUBOOT=y
SB_CONFIG_PARTITION_MANAGER=y
SB_CONFIG_MERGED_HEX_FILES=y
SB_CONFIG_BOOT_SIGNATURE_TYPE_ECDSA_P256=y
SB_CONFIG_BOOT_SIGNATURE_KEY_FILE="${APP_DIR}/keys/dev-private.pem"
```

## west.yml
```
manifest:
  projects:
    - name: nrf
      url: https://github.com/nrfconnect/sdk-nrf
      revision: v3.4.0
      import: true
    - name: ncs-zigbee
      url: https://github.com/nrfconnect/ncs-zigbee
      revision: v1.4.0
  self:
    path: vimar-30805-platform
```

## prj.conf
```kconfig
CONFIG_LOG=y
CONFIG_LOG_DEFAULT_LEVEL=3
CONFIG_SERIAL=y
CONFIG_CONSOLE=y

CONFIG_FLASH=y
CONFIG_DISABLE_FLASH_PATCH=y
CONFIG_FLASH_MAP=y
CONFIG_STREAM_FLASH=y
CONFIG_SETTINGS=y
CONFIG_NVS=y
CONFIG_SETTINGS_NVS=y

CONFIG_BT=y
CONFIG_BT_PERIPHERAL=y
CONFIG_BT_DEVICE_NAME="Vimar30805-Dev"
CONFIG_BT_SMP=y
CONFIG_BT_FIXED_PASSKEY=y
CONFIG_BT_SETTINGS=y

CONFIG_MCUMGR=y
CONFIG_ZCBOR=y
CONFIG_MCUMGR_GRP_IMG=y
CONFIG_MCUMGR_GRP_OS=y
CONFIG_IMG_MANAGER=y
CONFIG_MCUMGR_TRANSPORT_BT=y
CONFIG_MCUMGR_TRANSPORT_BT_PERM_RW_AUTHEN=y
CONFIG_MCUMGR_TRANSPORT_BT_REASSEMBLY=y
CONFIG_MCUMGR_TRANSPORT_WORKQUEUE_STACK_SIZE=4608
CONFIG_MCUBOOT_IMG_MANAGER=y

CONFIG_BT_L2CAP_TX_MTU=498
CONFIG_BT_BUF_ACL_RX_SIZE=502
CONFIG_BT_BUF_ACL_TX_SIZE=502
CONFIG_BT_CTLR_DATA_LENGTH_MAX=251

CONFIG_ZIGBEE_ADD_ON=y
CONFIG_ZIGBEE_APP_UTILS=y
CONFIG_ZIGBEE_ROLE_ROUTER=y
CONFIG_HEAP_MEM_POOL_SIZE=2048
CONFIG_MAIN_THREAD_PRIORITY=7
CONFIG_SYSTEM_WORKQUEUE_STACK_SIZE=4608
```

## prj_ota.conf
```kconfig
# DK prototype: Zigbee application; BLE lives in the independent recovery image.
CONFIG_LOG=y
CONFIG_LOG_DEFAULT_LEVEL=3
CONFIG_USE_SEGGER_RTT=y
CONFIG_SEGGER_RTT_INIT_MODE_ALWAYS=y
CONFIG_LOG_BACKEND_RTT=y
CONFIG_LOG_BACKEND_UART=n
CONFIG_FLASH=y
CONFIG_DISABLE_FLASH_PATCH=y
CONFIG_FLASH_MAP=y
CONFIG_SETTINGS=y
CONFIG_NVS=y
CONFIG_SETTINGS_NVS=y
CONFIG_BT=n
CONFIG_MCUMGR=n
CONFIG_ZIGBEE_ADD_ON=y
CONFIG_ZIGBEE_APP_UTILS=y
CONFIG_ZIGBEE_ROLE_ROUTER=y
CONFIG_ZIGBEE_CHANNEL_SELECTION_MODE_MULTI=y
CONFIG_HEAP_MEM_POOL_SIZE=2048
CONFIG_MAIN_THREAD_PRIORITY=7
CONFIG_SYSTEM_WORKQUEUE_STACK_SIZE=4608
```

## prj_split_ota.conf
```kconfig
# Split OTA main: production logging disabled; BLE lives in independent recovery.
CONFIG_LOG=n
CONFIG_USE_SEGGER_RTT=n
CONFIG_LOG_BACKEND_RTT=n
CONFIG_LOG_BACKEND_UART=n
CONFIG_FLASH=y
CONFIG_DISABLE_FLASH_PATCH=y
CONFIG_FLASH_MAP=y
CONFIG_SETTINGS=y
CONFIG_NVS=y
CONFIG_SETTINGS_NVS=y
CONFIG_BT=n
CONFIG_MCUMGR=n
CONFIG_ZIGBEE_ADD_ON=y
CONFIG_ZIGBEE_APP_UTILS=y
CONFIG_ZIGBEE_ROLE_ROUTER=y
CONFIG_ZIGBEE_CHANNEL_SELECTION_MODE_MULTI=y
CONFIG_HEAP_MEM_POOL_SIZE=2048
CONFIG_MAIN_THREAD_PRIORITY=7
# Startup verifies the signed recovery/loader using the PSA crypto backend.
# Its nested calls overflowed the legacy2KiB main stack on the standalone DK.
CONFIG_MAIN_STACK_SIZE=8192
CONFIG_SYSTEM_WORKQUEUE_STACK_SIZE=4608

CONFIG_CBPRINTF_FP_SUPPORT=n
CONFIG_SIZE_OPTIMIZATIONS_AGGRESSIVE=y
CONFIG_VIMAR_P031_PROTECTION=y
CONFIG_VIMAR_OTA_SPLIT_STAGING=y
```

## sysbuild_ota.conf
```kconfig
SB_CONFIG_BOOTLOADER_MCUBOOT=y
SB_CONFIG_PARTITION_MANAGER=n
SB_CONFIG_MERGED_HEX_FILES=y
SB_CONFIG_BOOT_SIGNATURE_TYPE_ECDSA_P256=y
SB_CONFIG_BOOT_SIGNATURE_KEY_FILE="${APP_DIR}/keys/dev-private.pem"
SB_CONFIG_MCUBOOT_MODE_FIRMWARE_UPDATER=y
SB_CONFIG_FIRMWARE_LOADER_IMAGE_VIMAR_BLE=y
```

## vimar_zigbee.conf
```kconfig
# Application-only Vimar profile. Keep the installed loader/recovery untouched.
CONFIG_VIMAR_HARDWARE=y
CONFIG_BOOTLOADER_MCUBOOT=y
CONFIG_MCUBOOT_BOOTLOADER_MODE_FIRMWARE_UPDATER=y
CONFIG_DISABLE_FLASH_PATCH=n
CONFIG_GPIO=y
CONFIG_RETAINED_MEM=y
CONFIG_RETENTION=y
CONFIG_RETENTION_BOOT_MODE=y
CONFIG_SERIAL=n
CONFIG_CONSOLE=n
CONFIG_UART_CONSOLE=n
CONFIG_LOG_BACKEND_UART=n

CONFIG_VIMAR_ZIGBEE_OTA=y
CONFIG_PSA_CRYPTO=y
CONFIG_PSA_WANT_ALG_ECDSA=y
CONFIG_PSA_WANT_ALG_SHA_256=y
CONFIG_PSA_WANT_ECC_SECP_R1_256=y
CONFIG_PSA_WANT_KEY_TYPE_ECC_PUBLIC_KEY=y

# SDK Oberon gates public ECC import on the key-pair import dispatcher.
CONFIG_PSA_WANT_KEY_TYPE_ECC_KEY_PAIR_IMPORT=y
```

## zigbee_dk.conf
```kconfig
# The nRF52840 cannot retain two equal MCUboot slots with the current Zigbee,
# Bluetooth, and MCUmgr images. This DK-only profile exercises the Zigbee
# endpoint and state model while the base profile remains the validated BLE
# recovery/FOTA image.
CONFIG_BT=n
CONFIG_MCUMGR=n

# The DK UART device is not passed through by every development container.
# RTT keeps diagnostic logs observable over the already-connected J-Link.
CONFIG_USE_SEGGER_RTT=y
CONFIG_LOG_BACKEND_RTT=y
CONFIG_LOG_BACKEND_UART=n

# Scan the standard 2.4 GHz Zigbee channel set. Nordic's default single-channel
# profile uses channel 16, while third-party coordinators can use any channel.
CONFIG_ZIGBEE_CHANNEL_SELECTION_MODE_MULTI=y
```

## boards/allocation-trace.overlay
```dts
/* Independent256-byte allocation-event commits below the loop/fatal windows. */
&sram0 { reg = <0x20000000 0x0003fc00>; };
```

## boards/fault-diagnostics.overlay
```dts
/* Fixed256-byte fatal record window is outside the ordinary RAM allocator.
 * No object is placed here by the C runtime; only bounded volatile writes. */
&sram0 { reg = <0x20000000 0x0003fe00>; };
```

## boards/loop-trace.overlay
```dts
/* Independent256-byte window below the existing fatal journal and heap footer. */
&sram0 { reg = <0x20000000 0x0003fd00>; };
```

## boards/nrf52840dk_nrf52840_ota.overlay
```dts
#include "ota-partitions.dtsi"
/ {
	chosen {
		zephyr,code-partition = &slot0_partition;
	};
};
```

## boards/ota-loader.overlay
```dts
#include "ota-partitions.dtsi"
/ {
	chosen {
		zephyr,code-partition = &slot1_partition;
	};
};
```

## boards/ota-mcuboot.overlay
```dts
#include "ota-partitions.dtsi"
/ {
	chosen {
		zephyr,code-partition = &boot_partition;
	};
};
```

## src/main.c
```c
#include <zephyr/app_version.h>
#include <zephyr/kernel.h>
#include <zephyr/logging/log.h>
#include <zephyr/settings/settings.h>

#if defined(CONFIG_BT)
#include <zephyr/bluetooth/bluetooth.h>
#include <zephyr/bluetooth/conn.h>
#include <zephyr/mgmt/mcumgr/transport/smp_bt.h>
#endif

#include "zigbee_device.h"
#include "app_settings_backend.h"
#include "vimar_power_protection.h"
#include "boot_trace.h"
#include "fault_diag_zephyr.h"
#include "loop_trace_zephyr.h"
#if defined(CONFIG_VIMAR_ZIGBEE_OTA)
#include "ota_storage.h"
#endif

LOG_MODULE_REGISTER(vimar_platform, LOG_LEVEL_INF);

#if defined(CONFIG_BT)
static struct k_work advertise_work;

static const struct bt_data advertising_data[] = {
	BT_DATA_BYTES(BT_DATA_FLAGS, BT_LE_AD_GENERAL | BT_LE_AD_NO_BREDR),
	BT_DATA_BYTES(BT_DATA_UUID128_ALL, SMP_BT_SVC_UUID_VAL),
};

static const struct bt_data scan_response[] = {
	BT_DATA(BT_DATA_NAME_COMPLETE, CONFIG_BT_DEVICE_NAME,
		sizeof(CONFIG_BT_DEVICE_NAME) - 1),
};

static void advertise(struct k_work *work)
{
	ARG_UNUSED(work);
	int error = bt_le_adv_start(BT_LE_ADV_CONN_FAST_1, advertising_data,
				    ARRAY_SIZE(advertising_data), scan_response,
				    ARRAY_SIZE(scan_response));
	if (error != 0) {
		LOG_ERR("BLE advertising failed: %d", error);
	}
}

static void disconnected(struct bt_conn *connection, uint8_t reason)
{
	ARG_UNUSED(connection);
	LOG_INF("BLE disconnected: %u", reason);
}

static void connection_recycled(void)
{
	k_work_submit(&advertise_work);
	zigbee_device_start();
}

BT_CONN_CB_DEFINE(connection_callbacks) = {
	.disconnected = disconnected,
	.recycled = connection_recycled,
};

static void bluetooth_ready(int error)
{
	if (error != 0) {
		LOG_ERR("Bluetooth initialization failed: %d", error);
		return;
	}
	error = settings_load();
	if (error != 0) {
		LOG_ERR("Settings load failed: %d", error);
		return;
	}
	k_work_submit(&advertise_work);
}
#endif

int main(void)
{
	app_settings_init();
	LOG_INF("Vimar 30805 development platform %s", APP_VERSION_STRING);
    LOG_INF("Hardware adapter: %s",IS_ENABLED(CONFIG_VIMAR_HARDWARE)?"Vimar":"DK simulator");
#if defined(CONFIG_BT)
	int error = bt_passkey_set(824005);
	if (error != 0) {
		LOG_ERR("Development passkey setup failed: %d", error);
		return 0;
	}
	k_work_init(&advertise_work, advertise);
	error = bt_enable(bluetooth_ready);
	if (error != 0) {
		LOG_ERR("Bluetooth enable failed: %d", error);
	}
#else
    int error = settings_subsys_init();
    if(error==0) { error=settings_load(); }
#if defined(CONFIG_VIMAR_P031_PROTECTION)
    int protection_error=vimar_power_protection_init();
    if(protection_error)LOG_ERR("P0.31 checkpoint unavailable; output inhibited: %d",protection_error);
    (void)vimar_boot_trace_begin(BOOT_IMAGE_MAIN);
#endif
#if defined(CONFIG_VIMAR_P031_PROTECTION)
    struct boot_trace_entry diag_boot;vimar_boot_trace_snapshot(&diag_boot);
    vimar_fault_diag_boot(diag_boot.sequence);
    vimar_loop_trace_boot(diag_boot.sequence);
#else
    vimar_fault_diag_boot(0);
    vimar_loop_trace_boot(0);
#endif
	if (error != 0) {
#if defined(CONFIG_VIMAR_P031_PROTECTION)
        vimar_power_protection_latch_input_failure();
#endif
		LOG_ERR("Settings unavailable; stopped before output/OTA routing: %d", error);
        return 0;
	}

#if defined(CONFIG_VIMAR_ZIGBEE_OTA)
    if(ota_storage_boot_route()!=0){LOG_ERR("OTA boot routing failed; staying before output init");return 0;}
#endif
	zigbee_device_start();
#endif
	return 0;
}
```

## src/app_settings_backend.c
```c
#include "app_settings_backend.h"
#include "settings_record.h"
#include "settings_store.h"
#include <errno.h>
#include <string.h>
#include <zephyr/settings/settings.h>

static struct dimmer_settings_store store;
static struct dimmer_config loaded_config;
static bool loaded_valid, loaded_on;
static uint8_t loaded_level;

static void save_record(const uint8_t *data, size_t length, void *unused)
{
    ARG_UNUSED(unused);
    (void)settings_save_one("vimar/app/state", data, length);
}

static int load_record(const char *name, size_t length, settings_read_cb read_cb,
                       void *cb_arg)
{
    if (strcmp(name, "state") != 0 || length > SETTINGS_RECORD_MAX_SIZE) return -ENOENT;
    uint8_t data[SETTINGS_RECORD_MAX_SIZE];
    ssize_t count = read_cb(cb_arg, data, length);
    if (count < 0) return (int)count;
    loaded_valid = settings_record_decode(data, (size_t)count, &loaded_config,
        &loaded_on, &loaded_level) == SETTINGS_RECORD_OK;
    if (loaded_valid) {
        memcpy(store.last, data, (size_t)count);
        store.last_length = (size_t)count;
    }
    return 0;
}

SETTINGS_STATIC_HANDLER_DEFINE(vimar_app, "vimar/app", NULL, load_record, NULL, NULL);

void app_settings_init(void) { dimmer_settings_store_init(&store, save_record, NULL); }
void app_settings_seed(const struct dimmer_config *config, bool on, uint8_t level)
{
    /* State-only saves must retain the actual startup configuration. */
    store.pending = *config;
    store.pending_on = on;
    store.pending_level = level;
}
bool app_settings_loaded(struct dimmer_config *config, bool *on, uint8_t *level)
{
    if (!loaded_valid) return false;
    *config = loaded_config; *on = loaded_on; *level = loaded_level; return true;
}
void app_settings_schedule_config(const struct dimmer_config *config, uint64_t now)
{ dimmer_settings_store_config_changed(&store, config, now); }
void app_settings_schedule_state(bool on, uint8_t level, uint64_t now)
{ dimmer_settings_store_state_changed(&store, on, level, now); }
void app_settings_tick(uint64_t now) { dimmer_settings_store_tick(&store, now); }
int app_settings_factory_reset(void) { loaded_valid = false; return settings_delete("vimar/app/state"); }

int app_settings_flush_current(const struct dimmer_config *config, bool on, uint8_t level)
{
    uint8_t data[SETTINGS_RECORD_MAX_SIZE];
    size_t length = 0;
    if (!settings_record_encode(config, on, level, data, sizeof(data), &length)) {
        return -EINVAL;
    }
    int error = settings_save_one("vimar/app/state", data, length);
    if (error) return error;
    /* Commit the cache only after durable storage accepted this exact state. */
    app_settings_seed(config, on, level);
    memcpy(store.last, data, length);
    store.last_length = length;
    store.dirty = false;
    store.state_dirty = false;
    return 0;
}
```

## src/app_settings_backend.h
```c
#ifndef VIMAR_APP_SETTINGS_BACKEND_H
#define VIMAR_APP_SETTINGS_BACKEND_H
#include <stdbool.h>
#include <stdint.h>
#include "dimmer_config.h"
void app_settings_init(void);
void app_settings_seed(const struct dimmer_config *, bool, uint8_t);
bool app_settings_loaded(struct dimmer_config *, bool *, uint8_t *);
void app_settings_schedule_config(const struct dimmer_config *, uint64_t);
void app_settings_schedule_state(bool, uint8_t, uint64_t);
void app_settings_tick(uint64_t);
int app_settings_flush_current(const struct dimmer_config *, bool, uint8_t);
int app_settings_factory_reset(void);
#endif
```

## src/application_controller.c
```c
#include "application_controller.h"
#include "local_action_mapper.h"
#include <string.h>
/* Output samples are command estimates, never measurements of the lamp. */
static void emit_output(struct application_controller *c,bool on,uint8_t level)
{
 c->emitting_output=true;
 if(c->callbacks.secondary_request)c->callbacks.secondary_request(c->context,c->model.state.operation_id,on,level);
 c->emitting_output=false;
}
static void advance_output(struct application_controller *c,uint64_t now)
{
 if(!c->output_pending||now<c->output_start_ms)return;
 uint64_t elapsed=now-c->output_start_ms;
 bool done=elapsed>=c->output_duration_ms;
 int value=done?c->ramp_to:(int)c->ramp_from+
     ((int)c->ramp_to-(int)c->ramp_from)*(int64_t)elapsed/c->output_duration_ms;
 bool on=value>0 && !(done && !c->ramp_target_on);
 uint8_t level=on?(uint8_t)value:c->model.state.level;
 if(on&&c->model.config.output_mode==DIMMER_OUTPUT_DIMMABLE){
     if(!c->ramp_cross_min && level<c->model.config.min_level)level=c->model.config.min_level;
     if(level>c->model.config.max_level)level=c->model.config.max_level;
 }
 if(on!=c->output_on||(on&&level!=c->output_level))emit_output(c,on,level);
 if(done)c->output_pending=false;
}
static void schedule_output(struct application_controller *c,uint64_t now,bool immediate)
{
 bool on=c->model.state.target_on && !c->protection_blocked;
 uint8_t level=c->model.state.target_level;
 if(!immediate&&c->output_pending&&c->ramp_target_on==on&&(!on||c->ramp_to==level)){
     (void)dimmer_model_apply_effective(&c->model,c->model.state.operation_id,on,level);
     if(c->callbacks.state_changed)c->callbacks.state_changed(c->context);
     return;
 }
 c->ramp_target_on=on;
 c->ramp_cross_min=!on || !c->output_on;
 c->ramp_from=c->output_on?c->output_level:0;c->ramp_to=on?level:0;
 if(on && !c->output_on){
  c->ramp_from=c->model.config.ramp_start_level;
  if(c->ramp_from>level)c->ramp_from=level;
 }
 if(!on){
  c->ramp_to=c->model.config.ramp_end_level;
  if(c->ramp_to>c->ramp_from)c->ramp_to=c->ramp_from;
 }
 c->output_start_ms=now+(!immediate&&on&&!c->output_on?c->model.config.initial_on_delay_ms:0);
 c->output_duration_ms=(immediate||c->model.config.output_mode!=DIMMER_OUTPUT_DIMMABLE)?0:(on && !c->output_on ?
     c->model.config.rise_transition_ms:c->ramp_to>c->ramp_from?
     c->model.config.rise_transition_ms:c->model.config.fall_transition_ms);
 /* At the operating minimum a fade becomes a silent wait rather than a
  * visible transition. Keep the separately configured initial ON delay. */
 bool minimum_on=on && !c->output_on && level<=c->model.config.min_level;
 bool minimum_off=!on && (!c->output_on || c->output_level<=c->model.config.min_level);
 if(minimum_on || minimum_off || c->ramp_from==c->ramp_to)c->output_duration_ms=0;
 /* Accepted state is independent of delayed/ramped output completion. */
 (void)dimmer_model_apply_effective(&c->model,c->model.state.operation_id,on,level);
 c->output_pending=true;
 if(c->callbacks.state_changed)c->callbacks.state_changed(c->context);
 if(c->output_start_ms==now&&c->output_duration_ms==0){
     emit_output(c,on,level);c->output_pending=false;
 }
}
static void send_request_mode(struct application_controller *c,bool on,uint8_t level,uint64_t now,bool immediate)
{
 if(c->protection_blocked){on=false;immediate=true;}
 (void)dimmer_model_request(&c->model,on,level,now);
 schedule_output(c,now,immediate);
}
static void send_request(struct application_controller *c,bool on,uint8_t level,uint64_t now)
{send_request_mode(c,on,level,now,false);}
static void ordinary_request(struct application_controller *c,bool on,uint8_t level,
 enum dimmer_request_source source,uint64_t now)
{
 send_request_mode(c,on,level,now,source==DIMMER_SOURCE_ZIGBEE_LEVEL||source==DIMMER_SOURCE_PHYSICAL_HOLD);
 if(!c->model.state.target_on||c->model.state.auto_off_bypassed)return;
 bool starts=c->model.config.auto_off_mode==DIMMER_AUTO_OFF_EVERY_ON||
  (c->model.config.auto_off_mode==DIMMER_AUTO_OFF_PHYSICAL_ON_ONLY&&(source==DIMMER_SOURCE_PHYSICAL||source==DIMMER_SOURCE_PHYSICAL_HOLD));
 if(starts)dimmer_model_start_off_timer(&c->model,now,c->model.config.auto_off_duration_s*1000U);
}
static void timed_on(struct application_controller *c,uint64_t now,uint32_t duration_s)
{send_request(c,true,c->model.state.level,now);if(c->model.state.on)dimmer_model_start_off_timer(&c->model,now,duration_s*1000U);}
static uint32_t template_duration(const struct dimmer_config *cfg,unsigned index)
{
 switch(index){case 1:return cfg->timer_2_duration_s;case 2:return cfg->timer_3_duration_s;
 case 3:return cfg->timer_4_duration_s;default:return cfg->timer_duration_s;}
}
static void bypass_on(struct application_controller *c,uint64_t now)
{send_request(c,true,c->model.state.level,now);if(!c->protection_blocked)dimmer_model_bypass_off_timer(&c->model);}
static bool front_hold_allowed(const struct application_controller *c)
{
 /* Accepted ON can precede applied output during the initial delay. */
 return !c->protection_blocked && c->model.config.output_mode==DIMMER_OUTPUT_DIMMABLE &&
     c->model.state.on && c->output_on;
}
static void classified(const struct gesture_event *e,void *ctx)
{
 struct application_controller *c=ctx;
 /* A press cannot be published before we know whether its click is disabled. */
 if(e->type==GESTURE_EVENT_PRESS){
  uint8_t *count=&c->queued_press_count[e->side];
  if(*count<2)c->queued_press[e->side][(*count)++]=*e;
  return;
 }
 enum dimmer_action a=local_action_for(&c->model.config,e->type,e->side);
 bool disabled=a==DIMMER_ACTION_DISABLED;
 if(!disabled && c->callbacks.gesture_event){
  for(uint8_t i=0;i<c->queued_press_count[e->side];i++)
   c->callbacks.gesture_event(c->context,&c->queued_press[e->side][i]);
  c->callbacks.gesture_event(c->context,e);
 }
 c->queued_press_count[e->side]=0;
 if(disabled)return;
 if(e->type==GESTURE_EVENT_LONG){if(!front_hold_allowed(c))return;int level=(int)c->model.state.level+local_action_level_delta(&c->model.config,e->side);if(level<1)level=1;if(level>254)level=254;ordinary_request(c,true,(uint8_t)level,DIMMER_SOURCE_PHYSICAL_HOLD,c->now_ms);c->hold_active[e->side]=true;c->next_level_step_ms[e->side]=c->now_ms+c->model.config.level_step_period_ms;return;}
 if(e->type==GESTURE_EVENT_RELEASE){c->hold_active[e->side]=false;return;}
 if(a>=DIMMER_ACTION_TIMED_ON_1 && a<=DIMMER_ACTION_TIMED_TOGGLE_4){
  bool toggle=a>=DIMMER_ACTION_TIMED_TOGGLE_1;
  unsigned index=(unsigned)(a-(toggle?DIMMER_ACTION_TIMED_TOGGLE_1:DIMMER_ACTION_TIMED_ON_1));
  if(toggle && c->model.state.on)ordinary_request(c,false,c->model.state.level,DIMMER_SOURCE_PHYSICAL,c->now_ms);
  else timed_on(c,c->now_ms,template_duration(&c->model.config,index));
  return;
 }
 switch(a){case DIMMER_ACTION_TOGGLE:ordinary_request(c,!c->model.state.on,c->model.state.level,DIMMER_SOURCE_PHYSICAL,c->now_ms);break;case DIMMER_ACTION_ON:ordinary_request(c,true,c->model.state.level,DIMMER_SOURCE_PHYSICAL,c->now_ms);break;case DIMMER_ACTION_OFF:ordinary_request(c,false,c->model.state.level,DIMMER_SOURCE_PHYSICAL,c->now_ms);break;case DIMMER_ACTION_TIMED_ON:timed_on(c,c->now_ms,c->model.config.timer_duration_s);break;case DIMMER_ACTION_BYPASS_ON:bypass_on(c,c->now_ms);break;default:break;}
}
void application_controller_cancel_attachment(struct application_controller *c)
{
 /* Keep the logical assertion until release, so cancellation cannot turn the
  * remaining hold or duplicate asserted edges into a fresh click. */
 if(c->attachment_pressed)c->attachment_cancelled=true;
}
void application_controller_attachment_settled(struct application_controller *c,bool settled)
{c->attachment_settled=settled;}
static void attachment_step(struct application_controller *c,uint64_t now)
{
 int level=(int)c->model.state.level+
     (c->attachment_down?-(int)c->model.config.level_step:(int)c->model.config.level_step);
 if(level<c->model.config.min_level)level=c->model.config.min_level;
 if(level>c->model.config.max_level)level=c->model.config.max_level;
 ordinary_request(c,true,(uint8_t)level,DIMMER_SOURCE_PHYSICAL_HOLD,now);
}
static void attachment_tick(struct application_controller *c,uint64_t now)
{
 if(!c->attachment_settled||!c->attachment_pressed||c->attachment_cancelled||c->protection_blocked)return;
 if(!c->attachment_long){
  if(now-c->attachment_pressed_ms<c->model.config.long_press_ms)return;
  c->attachment_long=true;
  /* Stock wired LONG does not turn an OFF light on. RELEASE still reverses
   * direction, independently of whether this hold produced output. */
  if(!c->model.state.on||c->model.config.output_mode!=DIMMER_OUTPUT_DIMMABLE)return;
  if(c->model.state.level<=c->model.config.min_level)c->attachment_down=false;
  if(c->model.state.level>=c->model.config.max_level)c->attachment_down=true;
  attachment_step(c,now);
  c->attachment_next_step_ms=now+c->model.config.level_step_period_ms;
 }else if(c->model.state.on&&c->model.config.output_mode==DIMMER_OUTPUT_DIMMABLE&&
          now>=c->attachment_next_step_ms&&c->attachment_next_step_ms){
  attachment_step(c,now);
  c->attachment_next_step_ms=now+c->model.config.level_step_period_ms;
 }
}
void application_controller_attachment_edge(struct application_controller *c,bool pressed,uint64_t now)
{
 c->now_ms=now;
 if(pressed){
  if(c->attachment_pressed)return;
  application_controller_cancel_gestures(c);
  dimmer_model_cancel_restore(&c->model);
  c->attachment_pressed=true;c->attachment_cancelled=c->protection_blocked;
  c->attachment_long=false;c->attachment_pressed_ms=now;c->attachment_next_step_ms=0;
  return;
 }
 if(!c->attachment_pressed)return;
 c->attachment_pressed=false;
 if(c->attachment_cancelled){c->attachment_cancelled=false;return;}
 bool was_long=c->attachment_long||now-c->attachment_pressed_ms>=c->model.config.long_press_ms;
 if(was_long)c->attachment_down=!c->attachment_down;
 else ordinary_request(c,!c->model.state.on,c->model.state.level,DIMMER_SOURCE_PHYSICAL,now);
}
void application_controller_init(struct application_controller *c,const struct dimmer_config *cfg,bool on,uint8_t level,const struct application_callbacks *cb,void *ctx,uint64_t now)
{memset(c,0,sizeof(*c));c->callbacks=*cb;c->context=ctx;dimmer_model_init_at(&c->model,cfg,on,level,now);c->output_on=c->model.state.on;c->output_level=c->model.state.level;c->attachment_settled=true;gesture_classifier_init(&c->gestures,cfg,classified,c);led_controller_init(&c->leds,cfg);}
void application_controller_button_edge(struct application_controller *c,enum gesture_side side,bool pressed,uint64_t now){c->now_ms=now;if(pressed){application_controller_cancel_attachment(c);dimmer_model_cancel_restore(&c->model);}gesture_classifier_edge(&c->gestures,side,pressed,now);}
void application_controller_command(struct application_controller *c,bool on,uint8_t level,enum dimmer_request_source source,uint64_t now){c->now_ms=now;if(source==DIMMER_SOURCE_ZIGBEE||source==DIMMER_SOURCE_ZIGBEE_LEVEL)application_controller_cancel_gestures(c);ordinary_request(c,on,level,source,now);}
void application_controller_bypass_on(struct application_controller *c,uint64_t now){c->now_ms=now;bypass_on(c,now);}
void application_controller_tick_input(struct application_controller *c,uint64_t now,bool settled){c->now_ms=now;attachment_tick(c,now);if(!front_hold_allowed(c))memset(c->hold_active,0,sizeof(c->hold_active));if(settled){gesture_classifier_tick(&c->gestures,now);for(enum gesture_side side=GESTURE_SIDE_UP;side<GESTURE_SIDE_COUNT;side++){if(c->hold_active[side]&&now>=c->next_level_step_ms[side]){int level=(int)c->model.state.level+local_action_level_delta(&c->model.config,side);if(level<1)level=1;if(level>254)level=254;ordinary_request(c,true,(uint8_t)level,DIMMER_SOURCE_PHYSICAL_HOLD,now);c->next_level_step_ms[side]+=c->model.config.level_step_period_ms;}}}bool timer=c->model.state.off_timer_active;bool restore=c->model.state.restore_waiting;if(dimmer_model_tick(&c->model,now)){if(c->callbacks.system_event)c->callbacks.system_event(c->context,timer?APPLICATION_EVENT_TIMER_EXPIRED:APPLICATION_EVENT_STATE_CORRECTION,0);schedule_output(c,now,false);}else if(restore&&!c->model.state.restore_waiting&&c->callbacks.system_event)c->callbacks.system_event(c->context,APPLICATION_EVENT_STATE_CORRECTION,0);advance_output(c,now);}
void application_controller_feedback(struct application_controller *c,uint32_t op,bool on,uint8_t level){if(c->protection_blocked&&on)return;if(c->emitting_output){if(op==c->model.state.operation_id){c->output_on=on;if(on)c->output_level=level;}return;}bool correction=op==c->model.state.operation_id&&(on!=c->model.state.target_on||level!=c->model.state.target_level);if(dimmer_model_apply_effective(&c->model,op,on,level)&&correction&&c->callbacks.system_event)c->callbacks.system_event(c->context,APPLICATION_EVENT_STATE_CORRECTION,0);}
const struct dimmer_state *application_controller_state(const struct application_controller *c){return dimmer_model_state(&c->model);}

void application_controller_cancel_gestures(struct application_controller *c)
{
 application_controller_cancel_attachment(c);
 memset(c->gestures.sides,0,sizeof(c->gestures.sides));
 memset(c->queued_press_count,0,sizeof(c->queued_press_count));
 memset(c->hold_active,0,sizeof(c->hold_active));
}
void application_controller_restore_handoff(struct application_controller *c,bool on,uint8_t level)
{
 if(c->protection_blocked)return;
 dimmer_model_cancel_restore(&c->model);
 c->model.state.on=c->model.state.target_on=on;
 c->model.state.level=c->model.state.target_level=level;
 c->model.previous_on=on;c->model.previous_level=level;
 c->output_on=on;c->output_level=level;c->output_pending=false;
}

void application_controller_tick(struct application_controller *c,uint64_t now){application_controller_tick_input(c,now,true);}

void application_controller_output_failed(struct application_controller *c,uint32_t op,enum dimmer_fault_code code)
{
 if(op!=c->model.state.operation_id||c->protection_blocked)return;
 c->output_pending=false;
 dimmer_model_fail(&c->model,op,code);
 (void)dimmer_model_apply_effective(&c->model,op,c->output_on,c->output_level);
 if(c->callbacks.state_changed)c->callbacks.state_changed(c->context);
}

void application_controller_set_protection(struct application_controller *c,bool blocked,uint64_t now)
{
 if(c->protection_blocked==blocked)return;
 c->protection_blocked=blocked;c->now_ms=now;
 /* Clearing permits fresh commands only; discard gestures queued while blocked. */
 application_controller_cancel_gestures(c);
 if(!blocked){
  dimmer_model_clear_fault(&c->model,DIMMER_FAULT_OUTPUT_INHIBITED);
  if(c->callbacks.state_changed)c->callbacks.state_changed(c->context);
  return;
 }
 c->output_pending=false;c->ramp_target_on=false;
 uint32_t op=dimmer_model_request(&c->model,false,c->model.state.level,now);
 (void)dimmer_model_apply_effective(&c->model,op,false,c->model.state.level);
 c->output_on=false;
 emit_output(c,false,c->model.state.level);
 dimmer_model_fail(&c->model,op,DIMMER_FAULT_OUTPUT_INHIBITED);
 if(c->callbacks.state_changed)c->callbacks.state_changed(c->context);
 if(c->callbacks.system_event)c->callbacks.system_event(c->context,APPLICATION_EVENT_FAULT,DIMMER_FAULT_OUTPUT_INHIBITED);
}
```

## src/application_controller.h
```c
#ifndef VIMAR_APPLICATION_CONTROLLER_H
#define VIMAR_APPLICATION_CONTROLLER_H
#include "dimmer_model.h"
#include "gesture_classifier.h"
#include "led_controller.h"
typedef void (*secondary_request_callback)(void *,uint32_t,bool,uint8_t);
typedef void (*application_gesture_callback)(void *,const struct gesture_event *);
enum application_system_event { APPLICATION_EVENT_TIMER_EXPIRED,
    APPLICATION_EVENT_RESTORE_REQUEST, APPLICATION_EVENT_STATE_CORRECTION,
    APPLICATION_EVENT_FAULT };
typedef void (*application_system_callback)(void *,enum application_system_event,uint16_t);
struct application_callbacks { secondary_request_callback secondary_request;
    application_gesture_callback gesture_event; application_system_callback system_event; void (*state_changed)(void *); };
struct application_controller { struct dimmer_model model;struct gesture_classifier gestures;struct led_controller leds;struct application_callbacks callbacks;void *context;uint64_t now_ms;struct gesture_event queued_press[GESTURE_SIDE_COUNT][2];uint8_t queued_press_count[GESTURE_SIDE_COUNT];bool hold_active[GESTURE_SIDE_COUNT];uint64_t next_level_step_ms[GESTURE_SIDE_COUNT]; bool protection_blocked, output_on, output_pending, emitting_output, ramp_target_on, ramp_cross_min; bool attachment_settled, attachment_pressed, attachment_cancelled, attachment_long, attachment_down; uint64_t attachment_pressed_ms, attachment_next_step_ms; uint8_t output_level, ramp_from, ramp_to; uint64_t output_start_ms; uint32_t output_duration_ms; };
enum dimmer_request_source { DIMMER_SOURCE_ZIGBEE, DIMMER_SOURCE_PHYSICAL, DIMMER_SOURCE_ZIGBEE_LEVEL, DIMMER_SOURCE_PHYSICAL_HOLD };
void application_controller_init(struct application_controller *,const struct dimmer_config *,bool,uint8_t,const struct application_callbacks *,void *,uint64_t);
void application_controller_button_edge(struct application_controller *,enum gesture_side,bool,uint64_t);
/* Normalized wired-input edges; never published as front-button gestures. */
void application_controller_attachment_edge(struct application_controller *,bool,uint64_t);
void application_controller_cancel_attachment(struct application_controller *);
void application_controller_attachment_settled(struct application_controller *,bool);
void application_controller_command(struct application_controller *,bool,uint8_t,enum dimmer_request_source,uint64_t);
void application_controller_bypass_on(struct application_controller *,uint64_t);
void application_controller_set_protection(struct application_controller *,bool,uint64_t);
void application_controller_cancel_gestures(struct application_controller *);
void application_controller_restore_handoff(struct application_controller *,bool,uint8_t);
void application_controller_tick_input(struct application_controller *,uint64_t,bool);
void application_controller_tick(struct application_controller *,uint64_t);
void application_controller_output_failed(struct application_controller *,uint32_t,enum dimmer_fault_code);
void application_controller_feedback(struct application_controller *,uint32_t,bool,uint8_t);
const struct dimmer_state *application_controller_state(const struct application_controller *);
#endif
```

## src/boot_trace.c
```c
#include "boot_trace.h"
#include <errno.h>
#include <limits.h>
#include <string.h>
static void put32(uint8_t*p,uint32_t n){for(unsigned i=0;i<4;i++)p[i]=(uint8_t)(n>>(8*i));}
static uint32_t get32(const uint8_t*p){return(uint32_t)p[0]|(uint32_t)p[1]<<8|(uint32_t)p[2]<<16|(uint32_t)p[3]<<24;}
static uint32_t crc32(const uint8_t*p,size_t n){uint32_t crc=UINT32_MAX;for(size_t i=0;i<n;i++){crc^=p[i];for(unsigned b=0;b<8;b++)crc=(crc>>1)^((crc&1)?0xedb88320u:0u);}return~crc;}
void boot_trace_request(struct boot_trace*t,enum boot_reason r)
{if(r>=BOOT_REASON_NONE&&r<=BOOT_REASON_BOOT_SELECTOR)t->pending_reason=(uint8_t)r;}
void boot_trace_begin(struct boot_trace*t,enum boot_image image,uint32_t flags)
{
 enum boot_reason reason=image==BOOT_IMAGE_MAIN?BOOT_REASON_MAIN_START:BOOT_REASON_RECOVERY_UNKNOWN;
 if(image==BOOT_IMAGE_RECOVERY&&(t->pending_reason==BOOT_REASON_ZIGBEE||t->pending_reason==BOOT_REASON_CHORD||t->pending_reason==BOOT_REASON_OTA_INSTALL||t->pending_reason==BOOT_REASON_BOOT_SELECTOR))reason=t->pending_reason;
 if(image==BOOT_IMAGE_MAIN&&t->pending_reason==BOOT_REASON_OTA_COMPLETE)reason=BOOT_REASON_OTA_COMPLETE;
 t->pending_reason=0;if(t->sequence<UINT32_MAX)t->sequence++;
 t->entries[t->next]=(struct boot_trace_entry){.sequence=t->sequence,.reset_flags=flags,.reason=reason,.image=image};
 t->next=(t->next+1)%BOOT_TRACE_ENTRIES;if(t->count<BOOT_TRACE_ENTRIES)t->count++;
}
const struct boot_trace_entry *boot_trace_last(const struct boot_trace*t)
{return t->count?&t->entries[(t->next+BOOT_TRACE_ENTRIES-1)%BOOT_TRACE_ENTRIES]:NULL;}
int boot_trace_chronological(const struct boot_trace*t,struct boot_trace_view*out)
{
 if(!out)return-EINVAL;
 struct boot_trace_view view={0};int rc=-EINVAL;
 if(t&&t->count<=BOOT_TRACE_ENTRIES&&t->next<BOOT_TRACE_ENTRIES&&t->pending_reason<=BOOT_REASON_BOOT_SELECTOR){
  view.sequence=t->sequence;view.count=t->count;view.pending_reason=t->pending_reason;
  unsigned oldest=(t->next+BOOT_TRACE_ENTRIES-t->count)%BOOT_TRACE_ENTRIES;
  for(unsigned i=0;i<t->count;i++)view.entries[i]=t->entries[(oldest+i)%BOOT_TRACE_ENTRIES];
  rc=0;
 }
 memcpy(out,&view,sizeof(view));return rc;
}
void boot_trace_encode(const struct boot_trace*t,uint8_t r[BOOT_TRACE_RECORD_SIZE])
{
 memset(r,0,BOOT_TRACE_RECORD_SIZE);put32(r,0x31544256u);r[4]=1;r[5]=t->count;r[6]=t->next;r[7]=t->pending_reason;put32(r+8,t->sequence);
 for(unsigned i=0;i<BOOT_TRACE_ENTRIES;i++){uint8_t*p=r+12+i*12;put32(p,t->entries[i].sequence);put32(p+4,t->entries[i].reset_flags);p[8]=t->entries[i].reason;p[9]=t->entries[i].image;}
 put32(r+84,crc32(r,84));
}
int boot_trace_decode(const uint8_t*r,size_t n,struct boot_trace*t)
{
 memset(t,0,sizeof(*t));
 if(!r||n!=BOOT_TRACE_RECORD_SIZE||get32(r)!=0x31544256u||r[4]!=1||r[5]>BOOT_TRACE_ENTRIES||r[6]>=BOOT_TRACE_ENTRIES||r[7]>BOOT_REASON_BOOT_SELECTOR||get32(r+84)!=crc32(r,84))return-EINVAL;
 for(unsigned i=0;i<BOOT_TRACE_ENTRIES;i++){const uint8_t*p=r+12+i*12;if(p[8]>BOOT_REASON_BOOT_SELECTOR||p[9]>BOOT_IMAGE_RECOVERY||p[10]||p[11])return-EINVAL;}
 t->count=r[5];t->next=r[6];t->pending_reason=r[7];t->sequence=get32(r+8);
 for(unsigned i=0;i<BOOT_TRACE_ENTRIES;i++){const uint8_t*p=r+12+i*12;t->entries[i]=(struct boot_trace_entry){.sequence=get32(p),.reset_flags=get32(p+4),.reason=p[8],.image=p[9]};}
 return 0;
}
```

## src/boot_trace.h
```c
#ifndef VIMAR_BOOT_TRACE_H
#define VIMAR_BOOT_TRACE_H
#include <stddef.h>
#include <stdint.h>
#include <stdbool.h>
#define BOOT_TRACE_ENTRIES 6u
#define BOOT_TRACE_RECORD_SIZE 88u
enum boot_image {BOOT_IMAGE_MAIN,BOOT_IMAGE_RECOVERY};
enum boot_reason {BOOT_REASON_NONE,BOOT_REASON_RECOVERY_UNKNOWN,BOOT_REASON_ZIGBEE,
 BOOT_REASON_CHORD,BOOT_REASON_OTA_INSTALL,BOOT_REASON_OTA_COMPLETE,BOOT_REASON_MAIN_START,
 BOOT_REASON_BOOT_SELECTOR};
struct boot_trace_entry {uint32_t sequence,reset_flags;uint8_t reason,image;};
struct boot_trace {uint8_t count,next,pending_reason;uint32_t sequence;struct boot_trace_entry entries[BOOT_TRACE_ENTRIES];};
/* Chronological ring view: oldest first, independent of sequence saturation. */
struct boot_trace_view {uint32_t sequence;uint8_t count,pending_reason;struct boot_trace_entry entries[BOOT_TRACE_ENTRIES];};
struct boot_trace_history {
 struct boot_trace_view view;
 int32_t load_result,decode_result,save_result,view_result;
 bool initialized,loaded_valid,storage_valid;
};
int boot_trace_chronological(const struct boot_trace *,struct boot_trace_view *);
void boot_trace_request(struct boot_trace *,enum boot_reason);
void boot_trace_begin(struct boot_trace *,enum boot_image,uint32_t);
const struct boot_trace_entry *boot_trace_last(const struct boot_trace *);
void boot_trace_encode(const struct boot_trace *,uint8_t [BOOT_TRACE_RECORD_SIZE]);
int boot_trace_decode(const uint8_t *,size_t,struct boot_trace *);
#if defined(CONFIG_VIMAR_P031_PROTECTION)
int vimar_boot_trace_begin(enum boot_image);
int vimar_boot_trace_request(enum boot_reason);
void vimar_boot_trace_snapshot(struct boot_trace_entry *);
void vimar_boot_trace_history_snapshot(struct boot_trace_history *);
#else
static inline int vimar_boot_trace_begin(enum boot_image image){(void)image;return 0;}
static inline int vimar_boot_trace_request(enum boot_reason reason){(void)reason;return 0;}
#endif
#endif
```

## src/boot_trace_zephyr.c
```c
#include "boot_trace.h"
#include <errno.h>
#include <string.h>
#include <limits.h>
#include <hal/nrf_power.h>
#include <zephyr/settings/settings.h>
#include <zephyr/kernel.h>
static struct boot_trace trace;
static int32_t load_result,decode_result,save_result;
static bool initialized,loaded_valid,storage_valid;
K_MUTEX_DEFINE(trace_mutex);
static int save(void){uint8_t record[BOOT_TRACE_RECORD_SIZE];boot_trace_encode(&trace,record);int rc=settings_save_one("vimar/boot_trace",record,sizeof(record));save_result=rc;storage_valid=rc==0;return rc;}
int vimar_boot_trace_begin(enum boot_image image)
{
 /* Available raw flags may already have been affected by the loader: do not
  * translate an empty register to a proven power-loss diagnosis. */
 uint32_t flags=nrf_power_resetreas_get(NRF_POWER);
 nrf_power_resetreas_clear(NRF_POWER,flags);
 k_mutex_lock(&trace_mutex,K_FOREVER);
 uint8_t record[BOOT_TRACE_RECORD_SIZE];ssize_t n=settings_load_one("vimar/boot_trace",record,sizeof(record));
 load_result=n>INT32_MAX||n<INT32_MIN?-EOVERFLOW:(int32_t)n;
 decode_result=0;loaded_valid=false;
 if(n>0){decode_result=boot_trace_decode(record,(size_t)n,&trace);loaded_valid=decode_result==0;}else memset(&trace,0,sizeof(trace));
 initialized=true;
 boot_trace_begin(&trace,image,flags);int rc=save();k_mutex_unlock(&trace_mutex);return rc;
}
int vimar_boot_trace_request(enum boot_reason reason)
{k_mutex_lock(&trace_mutex,K_FOREVER);boot_trace_request(&trace,reason);int rc=save();k_mutex_unlock(&trace_mutex);return rc;}
void vimar_boot_trace_snapshot(struct boot_trace_entry *out)
{k_mutex_lock(&trace_mutex,K_FOREVER);const struct boot_trace_entry*last=boot_trace_last(&trace);*out=last?*last:(struct boot_trace_entry){0};k_mutex_unlock(&trace_mutex);}
void vimar_boot_trace_history_snapshot(struct boot_trace_history *out)
{
 if(!out)return;
 struct boot_trace_history history={0};
 k_mutex_lock(&trace_mutex,K_FOREVER);
 history.view_result=boot_trace_chronological(&trace,&history.view);
 history.load_result=load_result;history.decode_result=decode_result;history.save_result=save_result;
 history.initialized=initialized;history.loaded_valid=loaded_valid;
 history.storage_valid=storage_valid&&history.view_result==0;
 k_mutex_unlock(&trace_mutex);
 memcpy(out,&history,sizeof(history));
}
```

## src/connection_capability.c
```c
#include <stdint.h>
#include "connection_capability.h"
/* Retained by an explicit linker root even under LTO/section GC. */
const uint8_t vimar_connection_pairing_capability[32]=CONNECTION_PAIRING_CAPABILITY_BYTES;
```

## src/connection_capability.h
```c
#ifndef VIMAR_CONNECTION_CAPABILITY_H
#define VIMAR_CONNECTION_CAPABILITY_H
/* Versioned descriptor inside the signed MAIN payload. SHA256 of
 * "Vomar Zigbee pairing intent protocol 1". It grants nothing before signature,
 * exact MAIN role/profile and payload-bound checks have succeeded. */
#define CONNECTION_PAIRING_CAPABILITY_BYTES { 0x32,0xde,0x35,0x86,0xc0,0x4a,0x47,0xa5,0xdd,0x5f,0x33,0x9a,0x4f,0x0a,0x87,0xde,0x1e,0xb2,0x27,0x93,0xef,0x1c,0x99,0x1f,0x11,0x80,0x72,0xd2,0x24,0xd3,0x36,0x09 }
#endif
```

## src/connection_intent.h
```c
#ifndef VIMAR_CONNECTION_INTENT_H
#define VIMAR_CONNECTION_INTENT_H
/* A dedicated settings key: never delete application settings or Bluetooth bonds. */
enum connection_intent {CONNECTION_INITIAL=0,CONNECTION_REQUESTED=1,CONNECTION_ATTEMPTED=2};
int connection_intent_load(void);
int connection_intent_request(void);
int connection_intent_claim(void);
#endif
```
