## firmware/common_restore/Kconfig
```kconfig
mainmenu "Isolated common stock restoration consumer"
source "Kconfig.zephyr"
config VIMAR_COMMON_RESTORE_EXPERIMENTAL
	bool "Isolated stock RESTORE source candidate"
	default n
config VIMAR_COMMON_RESTORE_BOOTSTRAP
	bool "Dedicated primary stock-bootstrap purpose"
	depends on VIMAR_COMMON_RESTORE_EXPERIMENTAL
	default n
```

## firmware/common_restore_gate/Kconfig
```kconfig
config VIMAR_COMMON_RESTORE_GATE
 bool "Source-only common RESTORE-role loader exception candidate"
 depends on MCUBOOT && SOC_NRF52840 && BOOT_FIRMWARE_LOADER && BOOT_VALIDATE_SLOT0 && FPROTECT
 depends on BOOT_SIGNATURE_TYPE_ECDSA_P256 && BOOT_USE_CC310 && BOOT_USE_NRF_CC310_BL && BOOT_FIH_PROFILE_OFF
 default n
 help
  Opt in only for reviewed common-loader experiments. Requires fresh real
  firmware-loader crypto validation followed by strict selected RESTORE-role
  parsing and committed local backup-anchor identity/UICR checks. Preserves
  full48KiB protection on all ordinary boots and admission errors. It cannot
  be combined with the existing device-bound exact-restorer wrapper module.
  Generic RESTORE code and Android anchor installation are separate work.

config VIMAR_INHERITED_WATCHDOG_HANDOFF
 bool "Wait for an inherited watchdog reset before normal boot"
 depends on VIMAR_COMMON_RESTORE_GATE
 default n
 help
  For first installation from stock firmware with a pause-on-HALT watchdog.
  An early loader hook waits without feeding WDT or entering ordinary boot
  until the real watchdog reset stops it. Inactive WDT adds no delay.
  Android admission requires this capability in the signed descriptor and
  checks the live watchdog profile; this option alone grants no installation.
```

## firmware/loader_contract/Kconfig.runtime
```kconfig
config VIMAR_LOADER_RUNTIME_V2
    bool "Opt-in typed common-loader runtime contract"
    depends on SOC_NRF52840 && VIMAR_OTA_SPLIT_STAGING
    default n
    help
      Requires a finite generated typed loader-contract header. Common families
      require a committed anchor and local live UID/UICR/geometry validation.
      Existing READ0 and exact legacy default remain unchanged. READ1 is added
      only to authenticated recovery identity when this option is explicitly on.
```

## firmware/restore_gate/Kconfig
```kconfig
config VIMAR_STOCK_RESTORE_GATE
 bool "Permit exact authenticated stock restorer to replace MCUboot"
 depends on MCUBOOT && SOC_NRF52840 && BOOT_FIRMWARE_LOADER && BOOT_VALIDATE_SLOT0 && FPROTECT
 depends on BOOT_SIGNATURE_TYPE_ECDSA_P256 && BOOT_USE_CC310 && BOOT_FIH_PROFILE_OFF
 default n

config VIMAR_STOCK_RESTORER_SHA256
 string "SHA256 of the entire authorized signed binary"
 depends on VIMAR_STOCK_RESTORE_GATE

config VIMAR_STOCK_RESTORER_SIZE
 int "Exact signed restorer binary size"
 range 1 258048
 depends on VIMAR_STOCK_RESTORE_GATE
 default 1
```
